/dts-v1/;

/ {

	fragment@0 {
		target = <0xffffffff>;

		__overlay__ {
		};
	};

	fragment@1 {
		target = <0xffffffff>;

		__overlay__ {

			fixedregulator@0 {
				compatible = "regulator-fixed";
				gpio = <0xffffffff 0x5f 0x00>;
				regulator-name = "sdio_fixed_3v3";
				regulator-min-microvolt = <0x325aa0>;
				regulator-max-microvolt = <0x325aa0>;
				enable-active-high;
				regulator-always-on;
				phandle = <0x65>;
			};
		};
	};

	fragment@2 {
		target = <0xffffffff>;

		__overlay__ {
			hardware = "mt8781";
		};
	};

	fragment@3 {
		target = <0xffffffff>;

		__overlay__ {
			compatible = "mediatek,pwm-leds";

			backlight {
				led_mode = <0x05>;
				pwms = <0xffffffff 0x00 0x99d9>;
				gate_enable = <0x00>;
				pwm_config = <0x00 0x01 0x00 0x00 0x00>;
				max-hw-brightness = <0x56c>;
				default-state = "on";
			};
		};
	};

	fragment@4 {
		target = <0xffffffff>;

		__overlay__ {

			lcd_bias_enp0 {
				phandle = <0x01>;

				pins_cmd_dat {
					pinmux = <0x9c00>;
					slew-rate = <0x01>;
					output-low;
				};
			};

			lcd_bias_enp1_gpio {
				phandle = <0x02>;

				pins_cmd_dat {
					pinmux = <0x9c00>;
					slew-rate = <0x01>;
					output-high;
				};
			};

			lcd_bias_enn0_gpio {
				phandle = <0x03>;

				pins_cmd_dat {
					pinmux = <0x9e00>;
					slew-rate = <0x01>;
					output-low;
				};
			};

			lcd_bias_enn1_gpio {
				phandle = <0x04>;

				pins_cmd_dat {
					pinmux = <0x9e00>;
					slew-rate = <0x01>;
					output-high;
				};
			};

			lcm_rst_out1_gpio {
				phandle = <0x05>;

				pins_cmd_dat {
					pinmux = <0x5500>;
					slew-rate = <0x01>;
					output-high;
				};
			};

			lcm_rst_out0_gpio {
				phandle = <0x06>;

				pins_cmd_dat {
					pinmux = <0x5500>;
					slew-rate = <0x01>;
					output-low;
				};
			};

			lcm_dsi_te {
				phandle = <0x07>;

				pins_cmd_dat {
					pinmux = <0x5301>;
				};
			};
		};
	};

	fragment@5 {
		target = <0xffffffff>;

		__overlay__ {
			pinctrl-names = "lcd_bias_enp0_gpio\0lcd_bias_enp1_gpio\0lcd_bias_enn0_gpio\0lcd_bias_enn1_gpio\0lcm_rst_out1_gpio\0lcm_rst_out0_gpio\0mode_te_te";
			pinctrl-0 = <0x01>;
			pinctrl-1 = <0x02>;
			pinctrl-2 = <0x03>;
			pinctrl-3 = <0x04>;
			pinctrl-4 = <0x05>;
			pinctrl-5 = <0x06>;
			pinctrl-6 = <0x07>;
			status = "okay";
		};
	};

	fragment@6 {
		target = <0xffffffff>;

		__overlay__ {
			pinctrl-names = "lcm_rst_out1_gpio\0lcm_rst_out0_gpio\0mode_te_te";
			pinctrl-0 = <0x05>;
			pinctrl-1 = <0x06>;
			pinctrl-2 = <0x07>;
			status = "okay";
		};
	};

	fragment@7 {
		target = <0xffffffff>;

		__overlay__ {
			status = "okay";
			#address-cells = <0x01>;
			#size-cells = <0x00>;

			panel1@0 {
				compatible = "boe,icnl9551r,vdo,60hz,dphy";
				reg = <0x00>;
				reset-gpios = <0xffffffff 0x55 0x00>;
				bias-gpios = <0xffffffff 0x9c 0x00 0xffffffff 0x9e 0x00>;
				pinctrl-names = "default";

				port {

					endpoint {
						remote-endpoint = <0x08>;
						phandle = <0x09>;
					};
				};
			};

			panel2@0 {
				compatible = "boe,icnl9551r,vdo,90hz,dphy";
				reg = <0x01>;
				reset-gpios = <0xffffffff 0x55 0x00>;
				bias-gpios = <0xffffffff 0x9c 0x00 0xffffffff 0x9e 0x00>;
				pinctrl-names = "default";

				port {

					endpoint {
						remote-endpoint = <0x08>;
						phandle = <0x66>;
					};
				};
			};

			panel3@0 {
				compatible = "boe,hx83102,vdo,90hz,dphy";
				reg = <0x02>;
				reset-gpios = <0xffffffff 0x55 0x00>;
				bias-gpios = <0xffffffff 0x9c 0x00 0xffffffff 0x9e 0x00>;
				pinctrl-names = "default";

				port {

					endpoint {
						remote-endpoint = <0x08>;
						phandle = <0x67>;
					};
				};
			};

			ports {

				port {

					endpoint {
						remote-endpoint = <0x09>;
						phandle = <0x08>;
					};
				};
			};
		};
	};

	fragment@8 {
		target = <0xffffffff>;

		__overlay__ {

			gps_default {
				phandle = <0x0a>;
			};

			gps_l1_lna@0 {
				phandle = <0x0b>;

				pins_cmd_dat {
					pinmux = <0x5600>;
					output-low;
				};
			};

			gps_l1_lna@1 {
				phandle = <0x0c>;

				pins_cmd_dat {
					pinmux = <0x5602>;
				};
			};

			gps_l1_lna@2 {
				phandle = <0x0d>;

				pins_cmd_dat {
					pinmux = <0x5600>;
					output-high;
				};
			};

			gps_l5_lna@0 {
				phandle = <0x0e>;

				pins_cmd_dat {
					pinmux = <0x1a00>;
					output-low;
				};
			};

			gps_l5_lna@1 {
				phandle = <0x0f>;

				pins_cmd_dat {
					pinmux = <0x1a02>;
				};
			};

			gps_l5_lna@2 {
				phandle = <0x10>;

				pins_cmd_dat {
					pinmux = <0x1a00>;
					output-high;
				};
			};
		};
	};

	fragment@9 {
		target = <0xffffffff>;

		__overlay__ {
			pinctrl-names = "default\0gps_l1_lna_disable\0gps_l1_lna_dsp_ctrl\0gps_l1_lna_enable\0gps_l5_lna_disable\0gps_l5_lna_dsp_ctrl\0gps_l5_lna_enable";
			pinctrl-0 = <0x0a>;
			pinctrl-1 = <0x0b>;
			pinctrl-2 = <0x0c>;
			pinctrl-3 = <0x0d>;
			pinctrl-4 = <0x0e>;
			pinctrl-5 = <0x0f>;
			pinctrl-6 = <0x10>;
			status = "okay";
		};
	};

	fragment@10 {
		target = <0xffffffff>;

		__overlay__ {

			lm3643@63 {
				compatible = "mediatek,lm3643";
				reg = <0x63>;
				#cooling-cells = <0x02>;
				pinctrl-names = "default\0hwen_high\0hwen_low";
				pinctrl-0 = <0x11>;
				pinctrl-1 = <0x12>;
				pinctrl-2 = <0x13>;
				status = "okay";
				phandle = <0x68>;

				flash@0 {
					reg = <0x00>;
					type = <0x00>;
					ct = <0x00>;
					part = <0x00>;

					port@0 {

						endpoint {
							remote-endpoint = <0x14>;
							phandle = <0x16>;
						};
					};
				};

				flash@1 {
					reg = <0x01>;
					type = <0x00>;
					ct = <0x01>;
					part = <0x00>;

					port@1 {

						endpoint {
							remote-endpoint = <0x15>;
							phandle = <0x17>;
						};
					};
				};
			};
		};
	};

	fragment@11 {
		target = <0xffffffff>;

		__overlay__ {

			default {
				phandle = <0x11>;
			};

			hwen_high {
				phandle = <0x12>;
			};

			hwen_low {
				phandle = <0x13>;
			};
		};
	};

	fragment@12 {
		target = <0xffffffff>;

		__overlay__ {

			port@0 {

				endpoint {
					remote-endpoint = <0x16>;
					phandle = <0x14>;
				};
			};

			port@1 {

				endpoint {
					remote-endpoint = <0x17>;
					phandle = <0x15>;
				};
			};
		};
	};

	fragment@13 {
		target = <0xffffffff>;

		__overlay__ {

			aw883xx_smartpa@34 {
				compatible = "awinic,aw883xx_smartpa";
				#sound-dai-cells = <0x00>;
				reg = <0x34>;
				reset-gpio = <0xffffffff 0x64 0x00>;
				sync-flag = <0x00>;
				sound-channel = <0x00>;
				re-min = <0x3e8>;
				re-max = <0x9c40>;
				hw-monitor-delay = <0x3e8>;
				aw-cali-mode = "aw_attr";
				fade-enable = <0x00>;
				status = "okay";
				phandle = <0x18>;
			};

			aw883xx_smartpa@36 {
				compatible = "awinic,aw883xx_smartpa";
				#sound-dai-cells = <0x00>;
				reg = <0x36>;
				sync-flag = <0x00>;
				sound-channel = <0x01>;
				re-min = <0x3e8>;
				re-max = <0x9c40>;
				hw-monitor-delay = <0x3e8>;
				aw-cali-mode = "aw_attr";
				fade-enable = <0x00>;
				status = "okay";
				phandle = <0x19>;
			};

			aw883xx_smartpa@35 {
				compatible = "awinic,aw883xx_smartpa";
				#sound-dai-cells = <0x00>;
				reg = <0x35>;
				sync-flag = <0x00>;
				sound-channel = <0x02>;
				re-min = <0x3e8>;
				re-max = <0x9c40>;
				hw-monitor-delay = <0x3e8>;
				aw-cali-mode = "aw_attr";
				fade-enable = <0x00>;
				status = "okay";
				phandle = <0x1a>;
			};

			aw883xx_smartpa@37 {
				compatible = "awinic,aw883xx_smartpa";
				#sound-dai-cells = <0x00>;
				reg = <0x37>;
				sync-flag = <0x00>;
				sound-channel = <0x03>;
				re-min = <0x3e8>;
				re-max = <0x9c40>;
				hw-monitor-delay = <0x3e8>;
				aw-cali-mode = "aw_attr";
				fade-enable = <0x00>;
				status = "okay";
				phandle = <0x1b>;
			};
		};
	};

	fragment@14 {
		target = <0xffffffff>;

		__overlay__ {
			mediatek,spk-i2s = <0x03 0x00>;

			mediatek,speaker-codec {
				sound-dai = <0x18 0x19 0x1a 0x1b>;
			};
		};
	};

	fragment@15 {
		target = <0xffffffff>;

		__overlay__ {
			clock-frequency = <0xf4240>;
			status = "okay";

			aw35615@22 {
				compatible = "awinic,aw35615";
				reg = <0x22>;
				awinic,int_n = <0xffffffff 0x0e 0x00>;
				aw35615,snk_pdo_size = <0x01>;
				aw35615,snk_pdo_vol = <0x1388>;
				aw35615,snk_pdo_cur = <0xbb8>;
				aw35615,src_pdo_size = <0x01>;
				aw35615,src_pdo_vol = <0x1388>;
				aw35615,src_pdo_cur = <0x7d0>;
				aw35615,snk_tog_time = <0x38>;
				aw35615,src_tog_time = <0x24>;
				status = "okay";
			};
		};
	};

	fragment@16 {
		target = <0xffffffff>;

		__overlay__ {
			compatible = "mediatek,lk_charger";
			enable_anime;
			enable_pd20_reset;
			power_path_support;
			max_charger_voltage = <0xaf79e0>;
			fast_charge_voltage = <0x2ab980>;
			usb_charger_current = <0x7a120>;
			ac_charger_current = <0x2191c0>;
			ac_charger_input_current = <0x1e8480>;
			non_std_ac_charger_current = <0x7a120>;
			charging_host_charger_current = <0x16e360>;
			ta_ac_charger_current = <0x2dc6c0>;
			pd_charger_current = <0x7a120>;
			temp_t4_threshold = <0x32>;
			temp_t3_threshold = <0x2d>;
			temp_t1_threshold = <0x00>;
			enable_check_vsys;
		};
	};

	fragment@17 {
		target = <0xffffffff>;

		__overlay__ {
			compatible = "mediatek,charger,pe4";
			gauge = <0xffffffff>;
			min_charger_voltage = <0x4630c0>;
			pe40_stop_battery_soc = <0x5a>;
			high_temp_to_leave_pe40 = <0x38>;
			high_temp_to_enter_pe40 = <0x32>;
			low_temp_to_leave_pe40 = <0x0a>;
			low_temp_to_enter_pe40 = <0x10>;
			ibus_err = <0x0e>;
			pe40_r_cable_1a_lower = <0x1f4>;
			pe40_r_cable_2a_lower = <0x15f>;
			pe40_r_cable_3a_lower = <0xf0>;
			sc_input_current = <0x2dc6c0>;
			sc_charger_current = <0x2dc6c0>;
			dcs_input_current = <0x2dc6c0>;
			dcs_chg1_charger_current = <0x2dc6c0>;
			dcs_chg2_charger_current = <0x2dc6c0>;
			dual_polling_ieoc = <0x6ddd0>;
			slave_mivr_diff = <0x186a0>;
			vbat_threshold = <0x1036>;
			odm_pe40_max_watt = <0x1f78a40>;
			odm_pe40_min_charge_current = <0x1f4>;
			odm_pe40_max_charge_current = <0xbb8>;
			odm_pe40_chg1_input_limit = <0xc8>;
			odm_pe40_min_charge_voltage = <0x1f4>;
			odm_pe40_max_charge_voltage = <0x2af8>;
			odm_pe40_min_charge_voltage_offset = <0x5dc>;
			odm_pe40_max_charge_voltage_offset = <0x7d0>;
			odm_pe40_max_ibat_current = <0x1964>;
			odm_pe40_constant_voltage_offset = <0x00>;
			odm_pe40_chg2_ibus_adc_support = <0x01>;
			odm_pe40_chg2_max_ibus = <0xb54>;
		};
	};

	fragment@18 {
		target = <0xffffffff>;

		__overlay__ {
			compatible = "mediatek,charger";
			gauge = <0xffffffff>;
			charger = <0xffffffff>;
			bootmode = <0xffffffff>;
			algorithm_name = "Basic";
			charger_configuration = <0x01>;
			battery_cv = <0x43e6d0>;
			max_charger_voltage = <0xaf79e0>;
			min_charger_voltage = <0x44aa20>;
			jeita_temp_above_t4_cv = <0x40b280>;
			jeita_temp_t3_to_t4_cv = <0x40b280>;
			jeita_temp_t2_to_t3_cv = <0x423920>;
			jeita_temp_t1_to_t2_cv = <0x40b280>;
			jeita_temp_t0_to_t1_cv = <0x3da540>;
			jeita_temp_below_t0_cv = <0x3da540>;
			temp_t4_thres = <0x32>;
			temp_t4_thres_minus_x_degree = <0x2f>;
			temp_t3_thres = <0x2d>;
			temp_t3_thres_minus_x_degree = <0x27>;
			temp_t2_thres = <0x0a>;
			temp_t2_thres_plus_x_degree = <0x10>;
			temp_t1_thres = <0x00>;
			temp_t1_thres_plus_x_degree = <0x06>;
			temp_t0_thres = <0x00>;
			temp_t0_thres_plus_x_degree = <0x00>;
			temp_neg_10_thres = <0x00>;
			enable_min_charge_temp;
			min_charge_temp = <0xfffffffb>;
			min_charge_temp_plus_x_degree = <0x00>;
			max_charge_temp = <0x37>;
			max_charge_temp_minus_x_degree = <0x32>;
			shutdown_high_temp = <0x3c>;
			shutdown_low_temp = <0xffffffe7>;
			usb_charger_current = <0x7a120>;
			ac_charger_current = <0x2191c0>;
			ac_charger_input_current = <0x1e8480>;
			ac_charger_ieoc = <0x6ddd0>;
			charging_host_charger_current = <0x16e360>;
			enable_dynamic_mivr;
			min_charger_voltage_1 = <0x432380>;
			min_charger_voltage_2 = <0x401640>;
			max_dmivr_charger_current = <0x1b7740>;
		};
	};

	fragment@19 {
		target = <0xffffffff>;

		__overlay__ {
			#address-cells = <0x01>;
			#size-cells = <0x00>;

			nu2116a-standalone@6E {
				compatible = "cp,nu2116a";
				status = "okay";
				chg_name = "secondary_chg";
				reg = <0x6e>;
				irq-gpios = <0xffffffff 0x06 0x00>;
				bat_ovp = <0x4c4b40>;
				bat_ocp = <0xd10ba0>;
				ac_ovp = <0xc65d40>;
				bus_ovp = <0xbc7230>;
				bus_ocp = <0x67c280>;
				ibat_sns_res = <0x02>;
				watchdog_dis;
				phandle = <0x69>;
			};
		};
	};

	fragment@20 {
		target = <0xffffffff>;

		__overlay__ {

			tsintdefault {
				phandle = <0x6a>;

				pins_cmd_dat {
					pinmux = <0x900>;
					input-enable;
				};
			};

			tsintoutlow {
				phandle = <0x6b>;

				pins_cmd_dat {
					pinmux = <0x900>;
					output-low;
				};
			};

			tsintouthigh {
				phandle = <0x6c>;

				pins_cmd_dat {
					pinmux = <0x900>;
					output-high;
				};
			};

			tsintinput {
				phandle = <0x6d>;

				pins_cmd_dat {
					pinmux = <0x900>;
					input-enable;
				};
			};
		};
	};

	fragment@21 {
		target = <0xffffffff>;

		__overlay__ {
			host-index = <0x01>;
			status = "okay";
			bus-width = <0x04>;
			max-frequency = <0xbebc200>;
			ocr-voltage = <0x30000>;
			cap-sd-highspeed;
			sd-uhs-sdr12;
			sd-uhs-sdr25;
			sd-uhs-sdr50;
			sd-uhs-sdr104;
			sd-uhs-ddr50;
			cd-debounce-delay-ms = <0x00>;
			cd-gpios = <0xffffffff 0x07 0x00>;
			vmmc-supply = <0xffffffff>;
			vqmmc-supply = <0xffffffff>;
			no-mmc;
			dvfsrc-vcore-supply = <0xffffffff>;
			req-vcore = <0x9eb10>;
		};
	};

	fragment@22 {
		target = <0xffffffff>;

		__overlay__ {
			status = "okay";

			st21nfc@08 {
				compatible = "st,st21nfc";
				reg = <0x08>;
				interrupt-parent = <0xffffffff>;
				interrupts = <0x66 0x00>;
				reset-gpios = <0xffffffff 0x67 0x00>;
				irq-gpios = <0xffffffff 0x66 0x00>;
				clkreq-gpios = <0xffffffff 0x59 0x00>;
				status = "okay";
				phandle = <0x6e>;
			};
		};
	};

	fragment@23 {
		target = <0xffffffff>;

		__overlay__ {

			extcon_pins_default {
				phandle = <0x1c>;
			};

			extcon_pins_otg_vbus_high {
				phandle = <0x1d>;

				pins_cmd_dat {
					pinmux = <0x9d00>;
					slew-rate = <0x01>;
					output-high;
				};
			};

			extcon_pins_otg_vbus_low {
				phandle = <0x1e>;

				pins_cmd_dat {
					pinmux = <0x9d00>;
					slew-rate = <0x01>;
					output-low;
				};
			};
		};
	};

	fragment@24 {
		target = <0xffffffff>;

		__overlay__ {
			id-gpios = <0xffffffff 0x6a 0x00>;
			pinctrl-names = "default\0state_otg_vbus_high\0state_otg_vbus_low";
			pinctrl-0 = <0x1c>;
			pinctrl-1 = <0x1d>;
			pinctrl-2 = <0x1e>;
			vbus-voltage = <0x00>;
			vbus-current = <0x00>;
			status = "okay";
		};
	};

	fragment@25 {
		target = <0xffffffff>;

		__overlay__ {

			odm_usb_hub_pins_default {
				phandle = <0x1f>;
			};

			odm_usb_hub_pins_typec_usb_switch_high {
				phandle = <0x20>;

				pins_cmd_dat {
					pinmux = <0x1200>;
					slew-rate = <0x01>;
					output-high;
				};
			};

			odm_usb_hub_pins_typec_usb_switch_low {
				phandle = <0x21>;

				pins_cmd_dat {
					pinmux = <0x1200>;
					slew-rate = <0x01>;
					output-low;
				};
			};

			odm_usb_hub_pins_keyboard_usb_switch_high {
				phandle = <0x22>;
			};

			odm_usb_hub_pins_keyboard_usb_switch_low {
				phandle = <0x23>;
			};
		};
	};

	fragment@26 {
		target = <0xffffffff>;

		__overlay__ {
			pinctrl-names = "default\0state_typec_usb_switch_high\0state_typec_usb_switch_low\0state_keyboard_usb_switch_high\0state_keyboard_usb_switch_low\0state_usb_typea_en_high\0state_usb_typea_en_low";
			pinctrl-0 = <0x1f>;
			pinctrl-1 = <0x20>;
			pinctrl-2 = <0x21>;
			pinctrl-3 = <0x22>;
			pinctrl-4 = <0x23>;
			status = "okay";
		};
	};

	fragment@27 {
		target = <0xffffffff>;

		__overlay__ {

			aw2023@45 {
				compatible = "awinic,aw2023_led";
				reg = <0x45>;

				aw2023,red {
					aw2023,name = "red";
					aw2023,id = <0x00>;
					aw2023,imax = <0x02>;
					aw2023,led-current = <0x0f>;
					aw2023,max-brightness = <0xff>;
					aw2023,rise-time-ms = <0x06>;
					aw2023,hold-time-ms = <0x00>;
					aw2023,fall-time-ms = <0x06>;
					aw2023,off-time-ms = <0x04>;
				};

				aw2023,green {
					aw2023,name = "green";
					aw2023,id = <0x01>;
					aw2023,imax = <0x02>;
					aw2023,led-current = <0x0f>;
					aw2023,max-brightness = <0xff>;
					aw2023,rise-time-ms = <0x06>;
					aw2023,hold-time-ms = <0x00>;
					aw2023,fall-time-ms = <0x06>;
					aw2023,off-time-ms = <0x04>;
				};

				aw2023,blue {
					aw2023,name = "blue";
					aw2023,id = <0x02>;
					aw2023,imax = <0x02>;
					aw2023,led-current = <0x0f>;
					aw2023,max-brightness = <0xff>;
					aw2023,rise-time-ms = <0x06>;
					aw2023,hold-time-ms = <0x00>;
					aw2023,fall-time-ms = <0x06>;
					aw2023,off-time-ms = <0x04>;
				};
			};
		};
	};

	fragment@28 {
		target = <0xffffffff>;

		__overlay__ {

			ch9434@0 {
				#address-cells = <0x01>;
				#size-cells = <0x01>;
				compatible = "wch,ch943x";
				ch9434,int-gpio = <0xffffffff 0x45 0x00>;
				reg = <0x00>;
				spi-max-frequency = <0x4c4b40>;
				status = "okay";
			};
		};
	};

	fragment@29 {
		target = <0xffffffff>;

		__overlay__ {
			clock-frequency = <0x61a80>;
			status = "okay";
		};
	};

	fragment@30 {
		target = <0xffffffff>;

		__overlay__ {

			spi5_miso_init {
				phandle = <0x24>;

				pins_cmd_dat {
					pinmux = <0x3101>;
					slew-rate = <0x00>;
					bias-pull-up = <0x00>;
				};
			};

			spi5_mosi_init {
				phandle = <0x25>;

				pins_cmd_dat {
					pinmux = <0x3001>;
					slew-rate = <0x01>;
					bias-pull-up = <0x00>;
				};
			};

			spi5_cs_init {
				phandle = <0x26>;

				pins_cmd_dat {
					pinmux = <0x2f01>;
					slew-rate = <0x01>;
					bias-pull-up = <0x00>;
				};
			};

			spi5_clk_init {
				phandle = <0x27>;

				pins_cmd_dat {
					pinmux = <0x2e01>;
					slew-rate = <0x01>;
					bias-pull-up = <0x00>;
				};
			};
		};
	};

	fragment@31 {
		target = <0xffffffff>;

		__overlay__ {
			spi5_cs2 = <0xffffffff 0x41 0x00>;
			spi5_cs3 = <0xffffffff 0x40 0x00>;
			hdmi_spi_lsen = <0xffffffff 0x65 0x00>;
			fpga_121_en = <0xffffffff 0x73 0x00>;
			fpga_256_en = <0xffffffff 0x72 0x00>;
			pinctrl-names = "spi_miso_init\0spi_mosi_init\0spi_cs_init\0spi_clk_init";
			pinctrl-0 = <0x24>;
			pinctrl-1 = <0x25>;
			pinctrl-2 = <0x26>;
			pinctrl-3 = <0x27>;
		};
	};

	fragment@32 {
		target = <0xffffffff>;

		__overlay__ {
			tee-only;
			#address-cells = <0x01>;
			#size-cells = <0x00>;
			cs-gpios = <0xffffffff 0x2f 0x00 0xffffffff 0x3f 0x00>;

			fingerprint@0 {
				compatible = "goodix,goodix-fp";
				reg = <0x00>;
				spi-max-frequency = <0x7a1200>;
				netlink-event = <0x1e>;
				status = "okay";
			};

			spi_dev@5 {
				compatible = "spidev";
				reg = <0x01>;
				spi-max-frequency = <0x19bfcc0>;
				status = "okay";
			};
		};
	};

	fragment@33 {
		target = <0xffffffff>;

		__overlay__ {
			pinctrl-names = "default\0state_spi_rst_high\0state_spi_rst_low\0state_spi_eint_init\0state_spi_miso_init\0state_spi_mosi_init\0state_spi_cs_init\0state_spi_ck_init";
			pinctrl-0 = <0x28>;
			pinctrl-1 = <0x29>;
			pinctrl-2 = <0x2a>;
			pinctrl-3 = <0x2b>;
			pinctrl-4 = <0x2c>;
			pinctrl-5 = <0x2d>;
			pinctrl-6 = <0x2e>;
			pinctrl-7 = <0x2f>;
			status = "okay";
		};
	};

	fragment@34 {
		target = <0xffffffff>;

		__overlay__ {

			state_default {
				phandle = <0x28>;
			};

			state_spi_rst_high {
				phandle = <0x29>;

				pins_cmd_dat {
					pinmux = <0x2300>;
					slew-rate = <0x01>;
					output-high;
				};
			};

			state_spi_rst_low {
				phandle = <0x2a>;

				pins_cmd_dat {
					pinmux = <0x2300>;
					slew-rate = <0x01>;
					output-low;
				};
			};

			state_spi_eint_init {
				phandle = <0x2b>;

				pins_cmd_dat {
					pinmux = <0x800>;
					slew-rate = <0x00>;
					bias-disable;
				};
			};

			state_spi_miso_init {
				phandle = <0x2c>;

				pins_cmd_dat {
					pinmux = <0x3101>;
					slew-rate = <0x00>;
					bias-pull-up = <0x00>;
				};
			};

			state_spi_mosi_init {
				phandle = <0x2d>;

				pins_cmd_dat {
					pinmux = <0x3001>;
					slew-rate = <0x01>;
					bias-pull-up = <0x00>;
				};
			};

			state_spi_cs_init {
				phandle = <0x2e>;

				pins_cmd_dat {
					pinmux = <0x2f01>;
					slew-rate = <0x01>;
					bias-pull-up = <0x00>;
				};
			};

			state_spi_ck_init {
				phandle = <0x2f>;

				pins_cmd_dat {
					pinmux = <0x2e01>;
					slew-rate = <0x01>;
					bias-pull-up = <0x00>;
				};
			};
		};
	};

	fragment@35 {
		target = <0xffffffff>;

		__overlay__ {
			CAR_TUNE_VALUE = <0x62>;
			SHUTDOWN_1_TIME = <0x0f>;
			io-channels = <0xffffffff 0x03 0xffffffff 0x00 0xffffffff 0x0e 0xffffffff 0x0f 0xffffffff 0x10 0xffffffff 0x04>;
			io-channel-names = "pmic_battery_temp\0pmic_battery_voltage\0pmic_bif_voltage\0pmic_ptim_voltage\0pmic_ptim_r\0batteryID-channel";
			MULTI_BATTERY = <0x02>;
			g_FG_PSEUDO100 = <0x64 0x64 0x64 0x64 0x64 0x64 0x64 0x64 0x64 0x64 0x64 0x64 0x64 0x64 0x64 0x64 0x64 0x64 0x64 0x64 0x64 0x64 0x64 0x64 0x64 0x64 0x64 0x64 0x64 0x64 0x64 0x64 0x64 0x64 0x64 0x64 0x64 0x64 0x64 0x64>;
			battery0_profile_t0_num = <0x64>;
			battery0_profile_t0_col = <0x04>;
			battery0_profile_t0 = <0x00 0xacc0 0x184 0x184 0x767 0xac3d 0x184 0x184 0xece 0xabcc 0x184 0x184 0x1636 0xab53 0x188 0x188 0x1d9d 0xaada 0x188 0x188 0x2504 0xaa69 0x188 0x188 0x2c6b 0xa9e6 0x188 0x188 0x33d2 0xa977 0x188 0x188 0x3b3a 0xa8fc 0x188 0x188 0x42a1 0xa88d 0x191 0x191 0x4a08 0xa81e 0x191 0x191 0x516f 0xa7a4 0x191 0x191 0x58d6 0xa734 0x191 0x191 0x603e 0xa6bb 0x196 0x196 0x67a5 0xa5e6 0x196 0x196 0x6f0c 0xa562 0x196 0x196 0x7673 0xa4fd 0x19b 0x19b 0x7dda 0xa483 0x19b 0x19b 0x8542 0xa41d 0x1a2 0x1a2 0x8ca9 0xa3ae 0x1a2 0x1a2 0x9410 0xa33e 0x1a2 0x1a2 0x9b77 0xa2d9 0x1a8 0x1a8 0xa2de 0xa274 0x1a8 0x1a8 0xaa46 0xa203 0x1a8 0x1a8 0xb1ad 0xa19e 0x1b4 0x1b4 0xb914 0xa12f 0x1b4 0x1b4 0xc07b 0xa0ca 0x1b4 0x1b4 0xc7e2 0xa06e 0x1bb 0x1bb 0xcf4a 0xa009 0x1bb 0x1bb 0xd6b1 0x9fa4 0x1c2 0x1c2 0xde18 0x9f53 0x1c2 0x1c2 0xe57f 0x9eed 0x1c2 0x1c2 0xece6 0x9e92 0x1c7 0x1c7 0xf44e 0x9e4b 0x1d4 0x1d4 0xfbb5 0x9de6 0x1d4 0x1d4 0x1031c 0x9d94 0x1d4 0x1d4 0x10a83 0x9d39 0x1d4 0x1d4 0x111ea 0x9cf2 0x1d4 0x1d4 0x11952 0x9c97 0x1d4 0x1d4 0x120b9 0x9c50 0x1d4 0x1d4 0x12820 0x9bf4 0x1d4 0x1d4 0x12f87 0x9b85 0x1d4 0x1d4 0x136ee 0x9b0c 0x1d4 0x1d4 0x13e56 0x9a73 0x1d4 0x1d4 0x145bd 0x9a0e 0x1d4 0x1d4 0x14d24 0x99b3 0x1d4 0x1d4 0x1548b 0x996c 0x1d4 0x1d4 0x15bf2 0x992e 0x1d4 0x1d4 0x1635a 0x98e7 0x1d4 0x1d4 0x16ac1 0x98ab 0x1d4 0x1d4 0x17228 0x9878 0x1d4 0x1d4 0x1798f 0x983b 0x1d4 0x1d4 0x180f6 0x9809 0x1d4 0x1d4 0x1885e 0x97d5 0x1d4 0x1d4 0x18fc5 0x97ad 0x1d4 0x1d4 0x1972c 0x977a 0x1d4 0x1d4 0x19e93 0x9748 0x1d4 0x1d4 0x1a5fa 0x9729 0x1d4 0x1d4 0x1ad62 0x9701 0x1d4 0x1d4 0x1b4c9 0x96d8 0x1d4 0x1d4 0x1bc30 0x96ba 0x1d4 0x1d4 0x1c397 0x9692 0x1d4 0x1d4 0x1cafe 0x9672 0x1d4 0x1d4 0x1d266 0x9654 0x1d4 0x1d4 0x1d9cd 0x962c 0x1d4 0x1d4 0x1e134 0x9603 0x1d4 0x1d4 0x1e89b 0x95ef 0x1d4 0x1d4 0x1f002 0x95d1 0x1d4 0x1d4 0x1f76a 0x95bc 0x1d4 0x1d4 0x20638 0x9594 0x1d4 0x1d4 0x20d9f 0x9561 0x1d4 0x1d4 0x21506 0x951b 0x1d4 0x1d4 0x21c6e 0x94c9 0x1d4 0x1d4 0x223d5 0x9496 0x1d4 0x1d4 0x22b3c 0x9478 0x1d4 0x1d4 0x232a3 0x944f 0x1d4 0x1d4 0x23a0a 0x941d 0x1d4 0x1d4 0x24172 0x93ea 0x1d4 0x1d4 0x248d9 0x93c2 0x1d4 0x1d4 0x25040 0x9398 0x1d4 0x1d4 0x257a7 0x9384 0x1d4 0x1d4 0x25f0e 0x935c 0x1d4 0x1d4 0x26676 0x9329 0x1d4 0x1d4 0x26ddd 0x92f6 0x1d4 0x1d4 0x27544 0x92b0 0x1d4 0x1d4 0x27cab 0x927d 0x1d4 0x1d4 0x28412 0x9240 0x1d4 0x1d4 0x28b7a 0x91ee 0x1d4 0x1d4 0x292e1 0x91b2 0x1d4 0x1d4 0x29a48 0x919e 0x1d4 0x1d4 0x2a1af 0x919e 0x1d4 0x1d4 0x2a916 0x9189 0x1d4 0x1d4 0x2b07e 0x917f 0x1d4 0x1d4 0x2b7e5 0x916b 0x1d4 0x1d4 0x2bf4c 0x9138 0x1d4 0x1d4 0x2c6b3 0x904f 0x1d4 0x1d4 0x2ce1a 0x8ec3 0x1d4 0x1d4 0x2d582 0x8cb4 0x1d4 0x1d4 0x2dce9 0x89f9 0x1d4 0x1d4 0x2e450 0x8602 0x1d4 0x1d4>;
			battery0_profile_t1_num = <0x64>;
			battery0_profile_t1_col = <0x04>;
			battery0_profile_t1 = <0x00 0xad0a 0x1fe 0x1fe 0x767 0xac1f 0x1fe 0x1fe 0xece 0xab84 0x1fe 0x1fe 0x1636 0xab05 0x1fe 0x1fe 0x1d9d 0xaa8f 0x1fe 0x1fe 0x2504 0xaa1f 0x1fe 0x1fe 0x2c6b 0xa9af 0x1fe 0x1fe 0x33d2 0xa946 0x1fe 0x1fe 0x3b3a 0xa8d3 0x1fe 0x1fe 0x42a1 0xa861 0x1fe 0x1fe 0x4a08 0xa7eb 0x1fe 0x1fe 0x516f 0xa775 0x1fe 0x1fe 0x58d6 0xa6ff 0x1fe 0x1fe 0x603e 0xa686 0x1fe 0x1fe 0x67a5 0xa614 0x1fe 0x1fe 0x6f0c 0xa59e 0x1fe 0x1fe 0x7673 0xa528 0x1fe 0x1fe 0x7dda 0xa4b2 0x1fe 0x1fe 0x8542 0xa43f 0x1fe 0x1fe 0x8ca9 0xa35a 0x1fe 0x1fe 0x9410 0xa2e7 0x1fe 0x1fe 0x9b77 0xa278 0x1fe 0x1fe 0xa2de 0xa205 0x250 0x250 0xaa46 0xa195 0x250 0x250 0xb1ad 0xa126 0x250 0x250 0xb914 0xa0b9 0x250 0x250 0xc07b 0xa04d 0x250 0x250 0xc7e2 0x9fe0 0x250 0x250 0xcf4a 0x9f77 0x250 0x250 0xd6b1 0x9f11 0x250 0x250 0xde18 0x9ead 0x250 0x250 0xe57f 0x9e4a 0x250 0x250 0xece6 0x9dea 0x250 0x250 0xf44e 0x9d81 0x250 0x250 0xfbb5 0x9d11 0x270 0x270 0x1031c 0x9cab 0x270 0x270 0x10a83 0x9c4b 0x270 0x270 0x111ea 0x9beb 0x270 0x270 0x11952 0x9b3a 0x270 0x270 0x120b9 0x9add 0x270 0x270 0x12820 0x9a7a 0x27c 0x27c 0x12f87 0x9a0a 0x27c 0x27c 0x136ee 0x999a 0x27c 0x27c 0x13e56 0x9925 0x27c 0x27c 0x145bd 0x98b5 0x27c 0x27c 0x14d24 0x9852 0x27c 0x27c 0x1548b 0x97f8 0x27c 0x27c 0x15bf2 0x97a7 0x27c 0x27c 0x1635a 0x9763 0x27c 0x27c 0x16ac1 0x971f 0x27c 0x27c 0x17228 0x96e1 0x27c 0x27c 0x1798f 0x96a3 0x27c 0x27c 0x180f6 0x966b 0x27c 0x27c 0x1885e 0x9636 0x27c 0x27c 0x18fc5 0x9602 0x27c 0x27c 0x1972c 0x95d0 0x27c 0x27c 0x19e93 0x95a2 0x27c 0x27c 0x1a5fa 0x954b 0x27c 0x27c 0x1ad62 0x951f 0x27c 0x27c 0x1b4c9 0x94f7 0x27c 0x27c 0x1bc30 0x94cf 0x27c 0x27c 0x1c397 0x94aa 0x27c 0x27c 0x1cafe 0x9484 0x27c 0x27c 0x1d266 0x9465 0x27c 0x27c 0x1d9cd 0x9440 0x27c 0x27c 0x1e134 0x941e 0x27c 0x27c 0x1e89b 0x93fc 0x27c 0x27c 0x1f002 0x93da 0x2a2 0x2a2 0x1f76a 0x93bb 0x2a2 0x2a2 0x20638 0x9393 0x2a2 0x2a2 0x20d9f 0x936d 0x2a2 0x2a2 0x21506 0x9342 0x2a2 0x2a2 0x21c6e 0x931a 0x2a2 0x2a2 0x223d5 0x92eb 0x2a2 0x2a2 0x22b3c 0x92c0 0x2a2 0x2a2 0x232a3 0x9294 0x2a2 0x2a2 0x23a0a 0x9241 0x2a2 0x2a2 0x24172 0x921b 0x2a2 0x2a2 0x248d9 0x91f9 0x2a2 0x2a2 0x25040 0x91d1 0x2a2 0x2a2 0x257a7 0x91a2 0x2a2 0x2a2 0x25f0e 0x9168 0x2a2 0x2a2 0x26676 0x9126 0x2a2 0x2a2 0x26ddd 0x90ef 0x2a2 0x2a2 0x27544 0x90b1 0x2bb 0x2bb 0x27cab 0x9060 0x2bb 0x2bb 0x28412 0x901c 0x2bb 0x2bb 0x28b7a 0x9000 0x2bb 0x2bb 0x292e1 0x8ff4 0x2bb 0x2bb 0x29a48 0x8fe7 0x2bb 0x2bb 0x2a1af 0x8fd8 0x2bb 0x2bb 0x2a916 0x8fb6 0x2bb 0x2bb 0x2b07e 0x8f71 0x2bb 0x2bb 0x2b7e5 0x8e9b 0x2bb 0x2bb 0x2bf4c 0x8ce3 0x2cd 0x2cd 0x2c6b3 0x8a9f 0x2cd 0x2cd 0x2ce1a 0x8789 0x2cd 0x2cd 0x2d582 0x83da 0x2df 0x2df 0x2dce9 0x830e 0x30d 0x30d 0x2e450 0x8257 0x30d 0x30d>;
			battery0_profile_t2_num = <0x64>;
			battery0_profile_t2_col = <0x04>;
			battery0_profile_t2 = <0x00 0xad0a 0x1fe 0x1fe 0x767 0xac1f 0x1fe 0x1fe 0xece 0xab84 0x1fe 0x1fe 0x1636 0xab05 0x1fe 0x1fe 0x1d9d 0xaa8f 0x1fe 0x1fe 0x2504 0xaa1f 0x1fe 0x1fe 0x2c6b 0xa9af 0x1fe 0x1fe 0x33d2 0xa946 0x1fe 0x1fe 0x3b3a 0xa8d3 0x1fe 0x1fe 0x42a1 0xa861 0x1fe 0x1fe 0x4a08 0xa7eb 0x1fe 0x1fe 0x516f 0xa775 0x1fe 0x1fe 0x58d6 0xa6ff 0x1fe 0x1fe 0x603e 0xa686 0x1fe 0x1fe 0x67a5 0xa614 0x1fe 0x1fe 0x6f0c 0xa59e 0x1fe 0x1fe 0x7673 0xa528 0x1fe 0x1fe 0x7dda 0xa4b2 0x1fe 0x1fe 0x8542 0xa43f 0x1fe 0x1fe 0x8ca9 0xa35a 0x1fe 0x1fe 0x9410 0xa2e7 0x1fe 0x1fe 0x9b77 0xa278 0x1fe 0x1fe 0xa2de 0xa205 0x250 0x250 0xaa46 0xa195 0x250 0x250 0xb1ad 0xa126 0x250 0x250 0xb914 0xa0b9 0x250 0x250 0xc07b 0xa04d 0x250 0x250 0xc7e2 0x9fe0 0x250 0x250 0xcf4a 0x9f77 0x250 0x250 0xd6b1 0x9f11 0x250 0x250 0xde18 0x9ead 0x250 0x250 0xe57f 0x9e4a 0x250 0x250 0xece6 0x9dea 0x250 0x250 0xf44e 0x9d81 0x250 0x250 0xfbb5 0x9d11 0x270 0x270 0x1031c 0x9cab 0x270 0x270 0x10a83 0x9c4b 0x270 0x270 0x111ea 0x9beb 0x270 0x270 0x11952 0x9b3a 0x270 0x270 0x120b9 0x9add 0x270 0x270 0x12820 0x9a7a 0x27c 0x27c 0x12f87 0x9a0a 0x27c 0x27c 0x136ee 0x999a 0x27c 0x27c 0x13e56 0x9925 0x27c 0x27c 0x145bd 0x98b5 0x27c 0x27c 0x14d24 0x9852 0x27c 0x27c 0x1548b 0x97f8 0x27c 0x27c 0x15bf2 0x97a7 0x27c 0x27c 0x1635a 0x9763 0x27c 0x27c 0x16ac1 0x971f 0x27c 0x27c 0x17228 0x96e1 0x27c 0x27c 0x1798f 0x96a3 0x27c 0x27c 0x180f6 0x966b 0x27c 0x27c 0x1885e 0x9636 0x27c 0x27c 0x18fc5 0x9602 0x27c 0x27c 0x1972c 0x95d0 0x27c 0x27c 0x19e93 0x95a2 0x27c 0x27c 0x1a5fa 0x954b 0x27c 0x27c 0x1ad62 0x951f 0x27c 0x27c 0x1b4c9 0x94f7 0x27c 0x27c 0x1bc30 0x94cf 0x27c 0x27c 0x1c397 0x94aa 0x27c 0x27c 0x1cafe 0x9484 0x27c 0x27c 0x1d266 0x9465 0x27c 0x27c 0x1d9cd 0x9440 0x27c 0x27c 0x1e134 0x941e 0x27c 0x27c 0x1e89b 0x93fc 0x27c 0x27c 0x1f002 0x93da 0x2a2 0x2a2 0x1f76a 0x93bb 0x2a2 0x2a2 0x20638 0x9393 0x2a2 0x2a2 0x20d9f 0x936d 0x2a2 0x2a2 0x21506 0x9342 0x2a2 0x2a2 0x21c6e 0x931a 0x2a2 0x2a2 0x223d5 0x92eb 0x2a2 0x2a2 0x22b3c 0x92c0 0x2a2 0x2a2 0x232a3 0x9294 0x2a2 0x2a2 0x23a0a 0x9241 0x2a2 0x2a2 0x24172 0x921b 0x2a2 0x2a2 0x248d9 0x91f9 0x2a2 0x2a2 0x25040 0x91d1 0x2a2 0x2a2 0x257a7 0x91a2 0x2a2 0x2a2 0x25f0e 0x9168 0x2a2 0x2a2 0x26676 0x9126 0x2a2 0x2a2 0x26ddd 0x90ef 0x2a2 0x2a2 0x27544 0x90b1 0x2bb 0x2bb 0x27cab 0x9060 0x2bb 0x2bb 0x28412 0x901c 0x2bb 0x2bb 0x28b7a 0x9000 0x2bb 0x2bb 0x292e1 0x8ff4 0x2bb 0x2bb 0x29a48 0x8fe7 0x2bb 0x2bb 0x2a1af 0x8fd8 0x2bb 0x2bb 0x2a916 0x8fb6 0x2bb 0x2bb 0x2b07e 0x8f71 0x2bb 0x2bb 0x2b7e5 0x8e9b 0x2bb 0x2bb 0x2bf4c 0x8ce3 0x2cd 0x2cd 0x2c6b3 0x8a9f 0x2cd 0x2cd 0x2ce1a 0x8789 0x2cd 0x2cd 0x2d582 0x83da 0x2df 0x2df 0x2dce9 0x830e 0x30d 0x30d 0x2e450 0x8257 0x30d 0x30d>;
			battery0_profile_t3_num = <0x64>;
			battery0_profile_t3_col = <0x04>;
			battery0_profile_t3 = <0x00 0xad4b 0x490 0x490 0x767 0xacbd 0x490 0x490 0xece 0xac44 0x490 0x490 0x1636 0xabda 0x490 0x490 0x1d9d 0xab74 0x490 0x490 0x2504 0xab11 0x490 0x490 0x2c6b 0xaab1 0x490 0x490 0x33d2 0xaa4e 0x490 0x490 0x3b3a 0xa9e7 0x490 0x490 0x42a1 0xa981 0x490 0x490 0x4a08 0xa91b 0x490 0x490 0x516f 0xa8ab 0x490 0x490 0x58d6 0xa83f 0x490 0x490 0x603e 0xa7cc 0x490 0x490 0x67a5 0xa75c 0x490 0x490 0x6f0c 0xa6ea 0x490 0x490 0x7673 0xa674 0x490 0x490 0x7dda 0xa601 0x490 0x490 0x8542 0xa588 0x490 0x490 0x8ca9 0xa4a0 0x495 0x495 0x9410 0xa42d 0x495 0x495 0x9b77 0xa3b7 0x555 0x555 0xa2de 0xa347 0x555 0x555 0xaa46 0xa2d5 0x555 0x555 0xb1ad 0xa262 0x555 0x555 0xb914 0xa1f2 0x555 0x555 0xc07b 0xa186 0x555 0x555 0xc7e2 0xa116 0x555 0x555 0xcf4a 0xa0aa 0x555 0x555 0xd6b1 0xa040 0x555 0x555 0xde18 0x9fd4 0x555 0x555 0xe57f 0x9f6e 0x555 0x555 0xece6 0x9f0a 0x555 0x555 0xf44e 0x9ea4 0x555 0x555 0xfbb5 0x9e44 0x555 0x555 0x1031c 0x9de1 0x555 0x555 0x10a83 0x9d84 0x599 0x599 0x111ea 0x9d24 0x599 0x599 0x11952 0x9c6d 0x599 0x599 0x120b9 0x9c13 0x599 0x599 0x12820 0x9bb9 0x599 0x599 0x12f87 0x9b59 0x599 0x599 0x136ee 0x9ae9 0x599 0x599 0x13e56 0x9a64 0x599 0x599 0x145bd 0x99d2 0x599 0x599 0x14d24 0x994d 0x599 0x599 0x1548b 0x98e0 0x599 0x599 0x15bf2 0x988d 0x599 0x599 0x1635a 0x983c 0x599 0x599 0x16ac1 0x97f5 0x599 0x599 0x17228 0x97b7 0x599 0x599 0x1798f 0x9776 0x599 0x599 0x180f6 0x9738 0x599 0x599 0x1885e 0x9700 0x599 0x599 0x18fc5 0x96c8 0x5b3 0x5b3 0x1972c 0x9693 0x5b3 0x5b3 0x19e93 0x965f 0x5b3 0x5b3 0x1a5fa 0x9602 0x5b3 0x5b3 0x1ad62 0x95d0 0x5b3 0x5b3 0x1b4c9 0x95a8 0x5b3 0x5b3 0x1bc30 0x957c 0x5b3 0x5b3 0x1c397 0x9554 0x5b3 0x5b3 0x1cafe 0x952f 0x5b3 0x5b3 0x1d266 0x950a 0x5b3 0x5b3 0x1d9cd 0x94e4 0x5b3 0x5b3 0x1e134 0x94c2 0x5b3 0x5b3 0x1e89b 0x94a0 0x5b3 0x5b3 0x1f002 0x9481 0x5c2 0x5c2 0x1f76a 0x9462 0x5c2 0x5c2 0x20638 0x943d 0x5c2 0x5c2 0x20d9f 0x9418 0x5c2 0x5c2 0x21506 0x93ec 0x5c2 0x5c2 0x21c6e 0x93b5 0x5c2 0x5c2 0x223d5 0x9383 0x5c2 0x5c2 0x22b3c 0x9355 0x5c2 0x5c2 0x232a3 0x9329 0x5c2 0x5c2 0x23a0a 0x92c3 0x5c2 0x5c2 0x24172 0x9297 0x5c2 0x5c2 0x248d9 0x926c 0x5c2 0x5c2 0x25040 0x924a 0x5c2 0x5c2 0x257a7 0x9222 0x5c2 0x5c2 0x25f0e 0x91f6 0x5c2 0x5c2 0x26676 0x91bb 0x5c2 0x5c2 0x26ddd 0x9177 0x5c2 0x5c2 0x27544 0x913c 0x5d1 0x5d1 0x27cab 0x9104 0x5d1 0x5d1 0x28412 0x90bd 0x5d1 0x5d1 0x28b7a 0x9066 0x5d1 0x5d1 0x292e1 0x903e 0x5d1 0x5d1 0x29a48 0x9032 0x5d1 0x5d1 0x2a1af 0x9025 0x5d1 0x5d1 0x2a916 0x9019 0x5d1 0x5d1 0x2b07e 0x9003 0x5e0 0x5e0 0x2b7e5 0x8fe4 0x5e0 0x5e0 0x2bf4c 0x8f87 0x5e0 0x5e0 0x2c6b3 0x8e42 0x5e0 0x5e0 0x2ce1a 0x8c51 0x5e0 0x5e0 0x2d582 0x89c6 0x5e0 0x5e0 0x2dce9 0x8634 0x5e0 0x5e0 0x2e450 0x8401 0x5e0 0x5e0>;
			battery0_profile_t4_num = <0x64>;
			battery0_profile_t4_col = <0x04>;
			battery0_profile_t4 = <0x00 0xad4b 0x490 0x490 0x767 0xacbd 0x490 0x490 0xece 0xac44 0x490 0x490 0x1636 0xabda 0x490 0x490 0x1d9d 0xab74 0x490 0x490 0x2504 0xab11 0x490 0x490 0x2c6b 0xaab1 0x490 0x490 0x33d2 0xaa4e 0x490 0x490 0x3b3a 0xa9e7 0x490 0x490 0x42a1 0xa981 0x490 0x490 0x4a08 0xa91b 0x490 0x490 0x516f 0xa8ab 0x490 0x490 0x58d6 0xa83f 0x490 0x490 0x603e 0xa7cc 0x490 0x490 0x67a5 0xa75c 0x490 0x490 0x6f0c 0xa6ea 0x490 0x490 0x7673 0xa674 0x490 0x490 0x7dda 0xa601 0x490 0x490 0x8542 0xa588 0x490 0x490 0x8ca9 0xa4a0 0x495 0x495 0x9410 0xa42d 0x495 0x495 0x9b77 0xa3b7 0x555 0x555 0xa2de 0xa347 0x555 0x555 0xaa46 0xa2d5 0x555 0x555 0xb1ad 0xa262 0x555 0x555 0xb914 0xa1f2 0x555 0x555 0xc07b 0xa186 0x555 0x555 0xc7e2 0xa116 0x555 0x555 0xcf4a 0xa0aa 0x555 0x555 0xd6b1 0xa040 0x555 0x555 0xde18 0x9fd4 0x555 0x555 0xe57f 0x9f6e 0x555 0x555 0xece6 0x9f0a 0x555 0x555 0xf44e 0x9ea4 0x555 0x555 0xfbb5 0x9e44 0x555 0x555 0x1031c 0x9de1 0x555 0x555 0x10a83 0x9d84 0x599 0x599 0x111ea 0x9d24 0x599 0x599 0x11952 0x9c6d 0x599 0x599 0x120b9 0x9c13 0x599 0x599 0x12820 0x9bb9 0x599 0x599 0x12f87 0x9b59 0x599 0x599 0x136ee 0x9ae9 0x599 0x599 0x13e56 0x9a64 0x599 0x599 0x145bd 0x99d2 0x599 0x599 0x14d24 0x994d 0x599 0x599 0x1548b 0x98e0 0x599 0x599 0x15bf2 0x988d 0x599 0x599 0x1635a 0x983c 0x599 0x599 0x16ac1 0x97f5 0x599 0x599 0x17228 0x97b7 0x599 0x599 0x1798f 0x9776 0x599 0x599 0x180f6 0x9738 0x599 0x599 0x1885e 0x9700 0x599 0x599 0x18fc5 0x96c8 0x5b3 0x5b3 0x1972c 0x9693 0x5b3 0x5b3 0x19e93 0x965f 0x5b3 0x5b3 0x1a5fa 0x9602 0x5b3 0x5b3 0x1ad62 0x95d0 0x5b3 0x5b3 0x1b4c9 0x95a8 0x5b3 0x5b3 0x1bc30 0x957c 0x5b3 0x5b3 0x1c397 0x9554 0x5b3 0x5b3 0x1cafe 0x952f 0x5b3 0x5b3 0x1d266 0x950a 0x5b3 0x5b3 0x1d9cd 0x94e4 0x5b3 0x5b3 0x1e134 0x94c2 0x5b3 0x5b3 0x1e89b 0x94a0 0x5b3 0x5b3 0x1f002 0x9481 0x5c2 0x5c2 0x1f76a 0x9462 0x5c2 0x5c2 0x20638 0x943d 0x5c2 0x5c2 0x20d9f 0x9418 0x5c2 0x5c2 0x21506 0x93ec 0x5c2 0x5c2 0x21c6e 0x93b5 0x5c2 0x5c2 0x223d5 0x9383 0x5c2 0x5c2 0x22b3c 0x9355 0x5c2 0x5c2 0x232a3 0x9329 0x5c2 0x5c2 0x23a0a 0x92c3 0x5c2 0x5c2 0x24172 0x9297 0x5c2 0x5c2 0x248d9 0x926c 0x5c2 0x5c2 0x25040 0x924a 0x5c2 0x5c2 0x257a7 0x9222 0x5c2 0x5c2 0x25f0e 0x91f6 0x5c2 0x5c2 0x26676 0x91bb 0x5c2 0x5c2 0x26ddd 0x9177 0x5c2 0x5c2 0x27544 0x913c 0x5d1 0x5d1 0x27cab 0x9104 0x5d1 0x5d1 0x28412 0x90bd 0x5d1 0x5d1 0x28b7a 0x9066 0x5d1 0x5d1 0x292e1 0x903e 0x5d1 0x5d1 0x29a48 0x9032 0x5d1 0x5d1 0x2a1af 0x9025 0x5d1 0x5d1 0x2a916 0x9019 0x5d1 0x5d1 0x2b07e 0x9003 0x5e0 0x5e0 0x2b7e5 0x8fe4 0x5e0 0x5e0 0x2bf4c 0x8f87 0x5e0 0x5e0 0x2c6b3 0x8e42 0x5e0 0x5e0 0x2ce1a 0x8c51 0x5e0 0x5e0 0x2d582 0x89c6 0x5e0 0x5e0 0x2dce9 0x8634 0x5e0 0x5e0 0x2e450 0x8401 0x5e0 0x5e0>;
			battery0_profile_t5_num = <0x64>;
			battery0_profile_t5_col = <0x04>;
			battery0_profile_t5 = <0x00 0xad4b 0x490 0x490 0x767 0xacbd 0x490 0x490 0xece 0xac44 0x490 0x490 0x1636 0xabda 0x490 0x490 0x1d9d 0xab74 0x490 0x490 0x2504 0xab11 0x490 0x490 0x2c6b 0xaab1 0x490 0x490 0x33d2 0xaa4e 0x490 0x490 0x3b3a 0xa9e7 0x490 0x490 0x42a1 0xa981 0x490 0x490 0x4a08 0xa91b 0x490 0x490 0x516f 0xa8ab 0x490 0x490 0x58d6 0xa83f 0x490 0x490 0x603e 0xa7cc 0x490 0x490 0x67a5 0xa75c 0x490 0x490 0x6f0c 0xa6ea 0x490 0x490 0x7673 0xa674 0x490 0x490 0x7dda 0xa601 0x490 0x490 0x8542 0xa588 0x490 0x490 0x8ca9 0xa4a0 0x495 0x495 0x9410 0xa42d 0x495 0x495 0x9b77 0xa3b7 0x555 0x555 0xa2de 0xa347 0x555 0x555 0xaa46 0xa2d5 0x555 0x555 0xb1ad 0xa262 0x555 0x555 0xb914 0xa1f2 0x555 0x555 0xc07b 0xa186 0x555 0x555 0xc7e2 0xa116 0x555 0x555 0xcf4a 0xa0aa 0x555 0x555 0xd6b1 0xa040 0x555 0x555 0xde18 0x9fd4 0x555 0x555 0xe57f 0x9f6e 0x555 0x555 0xece6 0x9f0a 0x555 0x555 0xf44e 0x9ea4 0x555 0x555 0xfbb5 0x9e44 0x555 0x555 0x1031c 0x9de1 0x555 0x555 0x10a83 0x9d84 0x599 0x599 0x111ea 0x9d24 0x599 0x599 0x11952 0x9c6d 0x599 0x599 0x120b9 0x9c13 0x599 0x599 0x12820 0x9bb9 0x599 0x599 0x12f87 0x9b59 0x599 0x599 0x136ee 0x9ae9 0x599 0x599 0x13e56 0x9a64 0x599 0x599 0x145bd 0x99d2 0x599 0x599 0x14d24 0x994d 0x599 0x599 0x1548b 0x98e0 0x599 0x599 0x15bf2 0x988d 0x599 0x599 0x1635a 0x983c 0x599 0x599 0x16ac1 0x97f5 0x599 0x599 0x17228 0x97b7 0x599 0x599 0x1798f 0x9776 0x599 0x599 0x180f6 0x9738 0x599 0x599 0x1885e 0x9700 0x599 0x599 0x18fc5 0x96c8 0x5b3 0x5b3 0x1972c 0x9693 0x5b3 0x5b3 0x19e93 0x965f 0x5b3 0x5b3 0x1a5fa 0x9602 0x5b3 0x5b3 0x1ad62 0x95d0 0x5b3 0x5b3 0x1b4c9 0x95a8 0x5b3 0x5b3 0x1bc30 0x957c 0x5b3 0x5b3 0x1c397 0x9554 0x5b3 0x5b3 0x1cafe 0x952f 0x5b3 0x5b3 0x1d266 0x950a 0x5b3 0x5b3 0x1d9cd 0x94e4 0x5b3 0x5b3 0x1e134 0x94c2 0x5b3 0x5b3 0x1e89b 0x94a0 0x5b3 0x5b3 0x1f002 0x9481 0x5c2 0x5c2 0x1f76a 0x9462 0x5c2 0x5c2 0x20638 0x943d 0x5c2 0x5c2 0x20d9f 0x9418 0x5c2 0x5c2 0x21506 0x93ec 0x5c2 0x5c2 0x21c6e 0x93b5 0x5c2 0x5c2 0x223d5 0x9383 0x5c2 0x5c2 0x22b3c 0x9355 0x5c2 0x5c2 0x232a3 0x9329 0x5c2 0x5c2 0x23a0a 0x92c3 0x5c2 0x5c2 0x24172 0x9297 0x5c2 0x5c2 0x248d9 0x926c 0x5c2 0x5c2 0x25040 0x924a 0x5c2 0x5c2 0x257a7 0x9222 0x5c2 0x5c2 0x25f0e 0x91f6 0x5c2 0x5c2 0x26676 0x91bb 0x5c2 0x5c2 0x26ddd 0x9177 0x5c2 0x5c2 0x27544 0x913c 0x5d1 0x5d1 0x27cab 0x9104 0x5d1 0x5d1 0x28412 0x90bd 0x5d1 0x5d1 0x28b7a 0x9066 0x5d1 0x5d1 0x292e1 0x903e 0x5d1 0x5d1 0x29a48 0x9032 0x5d1 0x5d1 0x2a1af 0x9025 0x5d1 0x5d1 0x2a916 0x9019 0x5d1 0x5d1 0x2b07e 0x9003 0x5e0 0x5e0 0x2b7e5 0x8fe4 0x5e0 0x5e0 0x2bf4c 0x8f87 0x5e0 0x5e0 0x2c6b3 0x8e42 0x5e0 0x5e0 0x2ce1a 0x8c51 0x5e0 0x5e0 0x2d582 0x89c6 0x5e0 0x5e0 0x2dce9 0x8634 0x5e0 0x5e0 0x2e450 0x8401 0x5e0 0x5e0>;
			battery1_profile_t0_num = <0x64>;
			battery1_profile_t0_col = <0x04>;
			battery1_profile_t0 = <0x00 0xacc0 0x184 0x184 0x767 0xac3d 0x184 0x184 0xece 0xabcc 0x184 0x184 0x1636 0xab53 0x188 0x188 0x1d9d 0xaada 0x188 0x188 0x2504 0xaa69 0x188 0x188 0x2c6b 0xa9e6 0x188 0x188 0x33d2 0xa977 0x188 0x188 0x3b3a 0xa8fc 0x188 0x188 0x42a1 0xa88d 0x191 0x191 0x4a08 0xa81e 0x191 0x191 0x516f 0xa7a4 0x191 0x191 0x58d6 0xa734 0x191 0x191 0x603e 0xa6bb 0x196 0x196 0x67a5 0xa5e6 0x196 0x196 0x6f0c 0xa562 0x196 0x196 0x7673 0xa4fd 0x19b 0x19b 0x7dda 0xa483 0x19b 0x19b 0x8542 0xa41d 0x1a2 0x1a2 0x8ca9 0xa3ae 0x1a2 0x1a2 0x9410 0xa33e 0x1a2 0x1a2 0x9b77 0xa2d9 0x1a8 0x1a8 0xa2de 0xa274 0x1a8 0x1a8 0xaa46 0xa203 0x1a8 0x1a8 0xb1ad 0xa19e 0x1b4 0x1b4 0xb914 0xa12f 0x1b4 0x1b4 0xc07b 0xa0ca 0x1b4 0x1b4 0xc7e2 0xa06e 0x1bb 0x1bb 0xcf4a 0xa009 0x1bb 0x1bb 0xd6b1 0x9fa4 0x1c2 0x1c2 0xde18 0x9f53 0x1c2 0x1c2 0xe57f 0x9eed 0x1c2 0x1c2 0xece6 0x9e92 0x1c7 0x1c7 0xf44e 0x9e4b 0x1d4 0x1d4 0xfbb5 0x9de6 0x1d4 0x1d4 0x1031c 0x9d94 0x1d4 0x1d4 0x10a83 0x9d39 0x1d4 0x1d4 0x111ea 0x9cf2 0x1d4 0x1d4 0x11952 0x9c97 0x1d4 0x1d4 0x120b9 0x9c50 0x1d4 0x1d4 0x12820 0x9bf4 0x1d4 0x1d4 0x12f87 0x9b85 0x1d4 0x1d4 0x136ee 0x9b0c 0x1d4 0x1d4 0x13e56 0x9a73 0x1d4 0x1d4 0x145bd 0x9a0e 0x1d4 0x1d4 0x14d24 0x99b3 0x1d4 0x1d4 0x1548b 0x996c 0x1d4 0x1d4 0x15bf2 0x992e 0x1d4 0x1d4 0x1635a 0x98e7 0x1d4 0x1d4 0x16ac1 0x98ab 0x1d4 0x1d4 0x17228 0x9878 0x1d4 0x1d4 0x1798f 0x983b 0x1d4 0x1d4 0x180f6 0x9809 0x1d4 0x1d4 0x1885e 0x97d5 0x1d4 0x1d4 0x18fc5 0x97ad 0x1d4 0x1d4 0x1972c 0x977a 0x1d4 0x1d4 0x19e93 0x9748 0x1d4 0x1d4 0x1a5fa 0x9729 0x1d4 0x1d4 0x1ad62 0x9701 0x1d4 0x1d4 0x1b4c9 0x96d8 0x1d4 0x1d4 0x1bc30 0x96ba 0x1d4 0x1d4 0x1c397 0x9692 0x1d4 0x1d4 0x1cafe 0x9672 0x1d4 0x1d4 0x1d266 0x9654 0x1d4 0x1d4 0x1d9cd 0x962c 0x1d4 0x1d4 0x1e134 0x9603 0x1d4 0x1d4 0x1e89b 0x95ef 0x1d4 0x1d4 0x1f002 0x95d1 0x1d4 0x1d4 0x1f76a 0x95bc 0x1d4 0x1d4 0x20638 0x9594 0x1d4 0x1d4 0x20d9f 0x9561 0x1d4 0x1d4 0x21506 0x951b 0x1d4 0x1d4 0x21c6e 0x94c9 0x1d4 0x1d4 0x223d5 0x9496 0x1d4 0x1d4 0x22b3c 0x9478 0x1d4 0x1d4 0x232a3 0x944f 0x1d4 0x1d4 0x23a0a 0x941d 0x1d4 0x1d4 0x24172 0x93ea 0x1d4 0x1d4 0x248d9 0x93c2 0x1d4 0x1d4 0x25040 0x9398 0x1d4 0x1d4 0x257a7 0x9384 0x1d4 0x1d4 0x25f0e 0x935c 0x1d4 0x1d4 0x26676 0x9329 0x1d4 0x1d4 0x26ddd 0x92f6 0x1d4 0x1d4 0x27544 0x92b0 0x1d4 0x1d4 0x27cab 0x927d 0x1d4 0x1d4 0x28412 0x9240 0x1d4 0x1d4 0x28b7a 0x91ee 0x1d4 0x1d4 0x292e1 0x91b2 0x1d4 0x1d4 0x29a48 0x919e 0x1d4 0x1d4 0x2a1af 0x919e 0x1d4 0x1d4 0x2a916 0x9189 0x1d4 0x1d4 0x2b07e 0x917f 0x1d4 0x1d4 0x2b7e5 0x916b 0x1d4 0x1d4 0x2bf4c 0x9138 0x1d4 0x1d4 0x2c6b3 0x904f 0x1d4 0x1d4 0x2ce1a 0x8ec3 0x1d4 0x1d4 0x2d582 0x8cb4 0x1d4 0x1d4 0x2dce9 0x89f9 0x1d4 0x1d4 0x2e450 0x8602 0x1d4 0x1d4>;
			battery1_profile_t1_num = <0x64>;
			battery1_profile_t1_col = <0x04>;
			battery1_profile_t1 = <0x00 0xad0a 0x1fe 0x1fe 0x767 0xac1f 0x1fe 0x1fe 0xece 0xab84 0x1fe 0x1fe 0x1636 0xab05 0x1fe 0x1fe 0x1d9d 0xaa8f 0x1fe 0x1fe 0x2504 0xaa1f 0x1fe 0x1fe 0x2c6b 0xa9af 0x1fe 0x1fe 0x33d2 0xa946 0x1fe 0x1fe 0x3b3a 0xa8d3 0x1fe 0x1fe 0x42a1 0xa861 0x1fe 0x1fe 0x4a08 0xa7eb 0x1fe 0x1fe 0x516f 0xa775 0x1fe 0x1fe 0x58d6 0xa6ff 0x1fe 0x1fe 0x603e 0xa686 0x1fe 0x1fe 0x67a5 0xa614 0x1fe 0x1fe 0x6f0c 0xa59e 0x1fe 0x1fe 0x7673 0xa528 0x1fe 0x1fe 0x7dda 0xa4b2 0x1fe 0x1fe 0x8542 0xa43f 0x1fe 0x1fe 0x8ca9 0xa35a 0x1fe 0x1fe 0x9410 0xa2e7 0x1fe 0x1fe 0x9b77 0xa278 0x1fe 0x1fe 0xa2de 0xa205 0x250 0x250 0xaa46 0xa195 0x250 0x250 0xb1ad 0xa126 0x250 0x250 0xb914 0xa0b9 0x250 0x250 0xc07b 0xa04d 0x250 0x250 0xc7e2 0x9fe0 0x250 0x250 0xcf4a 0x9f77 0x250 0x250 0xd6b1 0x9f11 0x250 0x250 0xde18 0x9ead 0x250 0x250 0xe57f 0x9e4a 0x250 0x250 0xece6 0x9dea 0x250 0x250 0xf44e 0x9d81 0x250 0x250 0xfbb5 0x9d11 0x270 0x270 0x1031c 0x9cab 0x270 0x270 0x10a83 0x9c4b 0x270 0x270 0x111ea 0x9beb 0x270 0x270 0x11952 0x9b3a 0x270 0x270 0x120b9 0x9add 0x270 0x270 0x12820 0x9a7a 0x27c 0x27c 0x12f87 0x9a0a 0x27c 0x27c 0x136ee 0x999a 0x27c 0x27c 0x13e56 0x9925 0x27c 0x27c 0x145bd 0x98b5 0x27c 0x27c 0x14d24 0x9852 0x27c 0x27c 0x1548b 0x97f8 0x27c 0x27c 0x15bf2 0x97a7 0x27c 0x27c 0x1635a 0x9763 0x27c 0x27c 0x16ac1 0x971f 0x27c 0x27c 0x17228 0x96e1 0x27c 0x27c 0x1798f 0x96a3 0x27c 0x27c 0x180f6 0x966b 0x27c 0x27c 0x1885e 0x9636 0x27c 0x27c 0x18fc5 0x9602 0x27c 0x27c 0x1972c 0x95d0 0x27c 0x27c 0x19e93 0x95a2 0x27c 0x27c 0x1a5fa 0x954b 0x27c 0x27c 0x1ad62 0x951f 0x27c 0x27c 0x1b4c9 0x94f7 0x27c 0x27c 0x1bc30 0x94cf 0x27c 0x27c 0x1c397 0x94aa 0x27c 0x27c 0x1cafe 0x9484 0x27c 0x27c 0x1d266 0x9465 0x27c 0x27c 0x1d9cd 0x9440 0x27c 0x27c 0x1e134 0x941e 0x27c 0x27c 0x1e89b 0x93fc 0x27c 0x27c 0x1f002 0x93da 0x2a2 0x2a2 0x1f76a 0x93bb 0x2a2 0x2a2 0x20638 0x9393 0x2a2 0x2a2 0x20d9f 0x936d 0x2a2 0x2a2 0x21506 0x9342 0x2a2 0x2a2 0x21c6e 0x931a 0x2a2 0x2a2 0x223d5 0x92eb 0x2a2 0x2a2 0x22b3c 0x92c0 0x2a2 0x2a2 0x232a3 0x9294 0x2a2 0x2a2 0x23a0a 0x9241 0x2a2 0x2a2 0x24172 0x921b 0x2a2 0x2a2 0x248d9 0x91f9 0x2a2 0x2a2 0x25040 0x91d1 0x2a2 0x2a2 0x257a7 0x91a2 0x2a2 0x2a2 0x25f0e 0x9168 0x2a2 0x2a2 0x26676 0x9126 0x2a2 0x2a2 0x26ddd 0x90ef 0x2a2 0x2a2 0x27544 0x90b1 0x2bb 0x2bb 0x27cab 0x9060 0x2bb 0x2bb 0x28412 0x901c 0x2bb 0x2bb 0x28b7a 0x9000 0x2bb 0x2bb 0x292e1 0x8ff4 0x2bb 0x2bb 0x29a48 0x8fe7 0x2bb 0x2bb 0x2a1af 0x8fd8 0x2bb 0x2bb 0x2a916 0x8fb6 0x2bb 0x2bb 0x2b07e 0x8f71 0x2bb 0x2bb 0x2b7e5 0x8e9b 0x2bb 0x2bb 0x2bf4c 0x8ce3 0x2cd 0x2cd 0x2c6b3 0x8a9f 0x2cd 0x2cd 0x2ce1a 0x8789 0x2cd 0x2cd 0x2d582 0x83da 0x2df 0x2df 0x2dce9 0x830e 0x30d 0x30d 0x2e450 0x8257 0x30d 0x30d>;
			battery1_profile_t2_num = <0x64>;
			battery1_profile_t2_col = <0x04>;
			battery1_profile_t2 = <0x00 0xad0a 0x1fe 0x1fe 0x767 0xac1f 0x1fe 0x1fe 0xece 0xab84 0x1fe 0x1fe 0x1636 0xab05 0x1fe 0x1fe 0x1d9d 0xaa8f 0x1fe 0x1fe 0x2504 0xaa1f 0x1fe 0x1fe 0x2c6b 0xa9af 0x1fe 0x1fe 0x33d2 0xa946 0x1fe 0x1fe 0x3b3a 0xa8d3 0x1fe 0x1fe 0x42a1 0xa861 0x1fe 0x1fe 0x4a08 0xa7eb 0x1fe 0x1fe 0x516f 0xa775 0x1fe 0x1fe 0x58d6 0xa6ff 0x1fe 0x1fe 0x603e 0xa686 0x1fe 0x1fe 0x67a5 0xa614 0x1fe 0x1fe 0x6f0c 0xa59e 0x1fe 0x1fe 0x7673 0xa528 0x1fe 0x1fe 0x7dda 0xa4b2 0x1fe 0x1fe 0x8542 0xa43f 0x1fe 0x1fe 0x8ca9 0xa35a 0x1fe 0x1fe 0x9410 0xa2e7 0x1fe 0x1fe 0x9b77 0xa278 0x1fe 0x1fe 0xa2de 0xa205 0x250 0x250 0xaa46 0xa195 0x250 0x250 0xb1ad 0xa126 0x250 0x250 0xb914 0xa0b9 0x250 0x250 0xc07b 0xa04d 0x250 0x250 0xc7e2 0x9fe0 0x250 0x250 0xcf4a 0x9f77 0x250 0x250 0xd6b1 0x9f11 0x250 0x250 0xde18 0x9ead 0x250 0x250 0xe57f 0x9e4a 0x250 0x250 0xece6 0x9dea 0x250 0x250 0xf44e 0x9d81 0x250 0x250 0xfbb5 0x9d11 0x270 0x270 0x1031c 0x9cab 0x270 0x270 0x10a83 0x9c4b 0x270 0x270 0x111ea 0x9beb 0x270 0x270 0x11952 0x9b3a 0x270 0x270 0x120b9 0x9add 0x270 0x270 0x12820 0x9a7a 0x27c 0x27c 0x12f87 0x9a0a 0x27c 0x27c 0x136ee 0x999a 0x27c 0x27c 0x13e56 0x9925 0x27c 0x27c 0x145bd 0x98b5 0x27c 0x27c 0x14d24 0x9852 0x27c 0x27c 0x1548b 0x97f8 0x27c 0x27c 0x15bf2 0x97a7 0x27c 0x27c 0x1635a 0x9763 0x27c 0x27c 0x16ac1 0x971f 0x27c 0x27c 0x17228 0x96e1 0x27c 0x27c 0x1798f 0x96a3 0x27c 0x27c 0x180f6 0x966b 0x27c 0x27c 0x1885e 0x9636 0x27c 0x27c 0x18fc5 0x9602 0x27c 0x27c 0x1972c 0x95d0 0x27c 0x27c 0x19e93 0x95a2 0x27c 0x27c 0x1a5fa 0x954b 0x27c 0x27c 0x1ad62 0x951f 0x27c 0x27c 0x1b4c9 0x94f7 0x27c 0x27c 0x1bc30 0x94cf 0x27c 0x27c 0x1c397 0x94aa 0x27c 0x27c 0x1cafe 0x9484 0x27c 0x27c 0x1d266 0x9465 0x27c 0x27c 0x1d9cd 0x9440 0x27c 0x27c 0x1e134 0x941e 0x27c 0x27c 0x1e89b 0x93fc 0x27c 0x27c 0x1f002 0x93da 0x2a2 0x2a2 0x1f76a 0x93bb 0x2a2 0x2a2 0x20638 0x9393 0x2a2 0x2a2 0x20d9f 0x936d 0x2a2 0x2a2 0x21506 0x9342 0x2a2 0x2a2 0x21c6e 0x931a 0x2a2 0x2a2 0x223d5 0x92eb 0x2a2 0x2a2 0x22b3c 0x92c0 0x2a2 0x2a2 0x232a3 0x9294 0x2a2 0x2a2 0x23a0a 0x9241 0x2a2 0x2a2 0x24172 0x921b 0x2a2 0x2a2 0x248d9 0x91f9 0x2a2 0x2a2 0x25040 0x91d1 0x2a2 0x2a2 0x257a7 0x91a2 0x2a2 0x2a2 0x25f0e 0x9168 0x2a2 0x2a2 0x26676 0x9126 0x2a2 0x2a2 0x26ddd 0x90ef 0x2a2 0x2a2 0x27544 0x90b1 0x2bb 0x2bb 0x27cab 0x9060 0x2bb 0x2bb 0x28412 0x901c 0x2bb 0x2bb 0x28b7a 0x9000 0x2bb 0x2bb 0x292e1 0x8ff4 0x2bb 0x2bb 0x29a48 0x8fe7 0x2bb 0x2bb 0x2a1af 0x8fd8 0x2bb 0x2bb 0x2a916 0x8fb6 0x2bb 0x2bb 0x2b07e 0x8f71 0x2bb 0x2bb 0x2b7e5 0x8e9b 0x2bb 0x2bb 0x2bf4c 0x8ce3 0x2cd 0x2cd 0x2c6b3 0x8a9f 0x2cd 0x2cd 0x2ce1a 0x8789 0x2cd 0x2cd 0x2d582 0x83da 0x2df 0x2df 0x2dce9 0x830e 0x30d 0x30d 0x2e450 0x8257 0x30d 0x30d>;
			battery1_profile_t3_num = <0x64>;
			battery1_profile_t3_col = <0x04>;
			battery1_profile_t3 = <0x00 0xad4b 0x490 0x490 0x767 0xacbd 0x490 0x490 0xece 0xac44 0x490 0x490 0x1636 0xabda 0x490 0x490 0x1d9d 0xab74 0x490 0x490 0x2504 0xab11 0x490 0x490 0x2c6b 0xaab1 0x490 0x490 0x33d2 0xaa4e 0x490 0x490 0x3b3a 0xa9e7 0x490 0x490 0x42a1 0xa981 0x490 0x490 0x4a08 0xa91b 0x490 0x490 0x516f 0xa8ab 0x490 0x490 0x58d6 0xa83f 0x490 0x490 0x603e 0xa7cc 0x490 0x490 0x67a5 0xa75c 0x490 0x490 0x6f0c 0xa6ea 0x490 0x490 0x7673 0xa674 0x490 0x490 0x7dda 0xa601 0x490 0x490 0x8542 0xa588 0x490 0x490 0x8ca9 0xa4a0 0x495 0x495 0x9410 0xa42d 0x495 0x495 0x9b77 0xa3b7 0x555 0x555 0xa2de 0xa347 0x555 0x555 0xaa46 0xa2d5 0x555 0x555 0xb1ad 0xa262 0x555 0x555 0xb914 0xa1f2 0x555 0x555 0xc07b 0xa186 0x555 0x555 0xc7e2 0xa116 0x555 0x555 0xcf4a 0xa0aa 0x555 0x555 0xd6b1 0xa040 0x555 0x555 0xde18 0x9fd4 0x555 0x555 0xe57f 0x9f6e 0x555 0x555 0xece6 0x9f0a 0x555 0x555 0xf44e 0x9ea4 0x555 0x555 0xfbb5 0x9e44 0x555 0x555 0x1031c 0x9de1 0x555 0x555 0x10a83 0x9d84 0x599 0x599 0x111ea 0x9d24 0x599 0x599 0x11952 0x9c6d 0x599 0x599 0x120b9 0x9c13 0x599 0x599 0x12820 0x9bb9 0x599 0x599 0x12f87 0x9b59 0x599 0x599 0x136ee 0x9ae9 0x599 0x599 0x13e56 0x9a64 0x599 0x599 0x145bd 0x99d2 0x599 0x599 0x14d24 0x994d 0x599 0x599 0x1548b 0x98e0 0x599 0x599 0x15bf2 0x988d 0x599 0x599 0x1635a 0x983c 0x599 0x599 0x16ac1 0x97f5 0x599 0x599 0x17228 0x97b7 0x599 0x599 0x1798f 0x9776 0x599 0x599 0x180f6 0x9738 0x599 0x599 0x1885e 0x9700 0x599 0x599 0x18fc5 0x96c8 0x5b3 0x5b3 0x1972c 0x9693 0x5b3 0x5b3 0x19e93 0x965f 0x5b3 0x5b3 0x1a5fa 0x9602 0x5b3 0x5b3 0x1ad62 0x95d0 0x5b3 0x5b3 0x1b4c9 0x95a8 0x5b3 0x5b3 0x1bc30 0x957c 0x5b3 0x5b3 0x1c397 0x9554 0x5b3 0x5b3 0x1cafe 0x952f 0x5b3 0x5b3 0x1d266 0x950a 0x5b3 0x5b3 0x1d9cd 0x94e4 0x5b3 0x5b3 0x1e134 0x94c2 0x5b3 0x5b3 0x1e89b 0x94a0 0x5b3 0x5b3 0x1f002 0x9481 0x5c2 0x5c2 0x1f76a 0x9462 0x5c2 0x5c2 0x20638 0x943d 0x5c2 0x5c2 0x20d9f 0x9418 0x5c2 0x5c2 0x21506 0x93ec 0x5c2 0x5c2 0x21c6e 0x93b5 0x5c2 0x5c2 0x223d5 0x9383 0x5c2 0x5c2 0x22b3c 0x9355 0x5c2 0x5c2 0x232a3 0x9329 0x5c2 0x5c2 0x23a0a 0x92c3 0x5c2 0x5c2 0x24172 0x9297 0x5c2 0x5c2 0x248d9 0x926c 0x5c2 0x5c2 0x25040 0x924a 0x5c2 0x5c2 0x257a7 0x9222 0x5c2 0x5c2 0x25f0e 0x91f6 0x5c2 0x5c2 0x26676 0x91bb 0x5c2 0x5c2 0x26ddd 0x9177 0x5c2 0x5c2 0x27544 0x913c 0x5d1 0x5d1 0x27cab 0x9104 0x5d1 0x5d1 0x28412 0x90bd 0x5d1 0x5d1 0x28b7a 0x9066 0x5d1 0x5d1 0x292e1 0x903e 0x5d1 0x5d1 0x29a48 0x9032 0x5d1 0x5d1 0x2a1af 0x9025 0x5d1 0x5d1 0x2a916 0x9019 0x5d1 0x5d1 0x2b07e 0x9003 0x5e0 0x5e0 0x2b7e5 0x8fe4 0x5e0 0x5e0 0x2bf4c 0x8f87 0x5e0 0x5e0 0x2c6b3 0x8e42 0x5e0 0x5e0 0x2ce1a 0x8c51 0x5e0 0x5e0 0x2d582 0x89c6 0x5e0 0x5e0 0x2dce9 0x8634 0x5e0 0x5e0 0x2e450 0x8401 0x5e0 0x5e0>;
			battery1_profile_t4_num = <0x64>;
			battery1_profile_t4_col = <0x04>;
			battery1_profile_t4 = <0x00 0xad4b 0x490 0x490 0x767 0xacbd 0x490 0x490 0xece 0xac44 0x490 0x490 0x1636 0xabda 0x490 0x490 0x1d9d 0xab74 0x490 0x490 0x2504 0xab11 0x490 0x490 0x2c6b 0xaab1 0x490 0x490 0x33d2 0xaa4e 0x490 0x490 0x3b3a 0xa9e7 0x490 0x490 0x42a1 0xa981 0x490 0x490 0x4a08 0xa91b 0x490 0x490 0x516f 0xa8ab 0x490 0x490 0x58d6 0xa83f 0x490 0x490 0x603e 0xa7cc 0x490 0x490 0x67a5 0xa75c 0x490 0x490 0x6f0c 0xa6ea 0x490 0x490 0x7673 0xa674 0x490 0x490 0x7dda 0xa601 0x490 0x490 0x8542 0xa588 0x490 0x490 0x8ca9 0xa4a0 0x495 0x495 0x9410 0xa42d 0x495 0x495 0x9b77 0xa3b7 0x555 0x555 0xa2de 0xa347 0x555 0x555 0xaa46 0xa2d5 0x555 0x555 0xb1ad 0xa262 0x555 0x555 0xb914 0xa1f2 0x555 0x555 0xc07b 0xa186 0x555 0x555 0xc7e2 0xa116 0x555 0x555 0xcf4a 0xa0aa 0x555 0x555 0xd6b1 0xa040 0x555 0x555 0xde18 0x9fd4 0x555 0x555 0xe57f 0x9f6e 0x555 0x555 0xece6 0x9f0a 0x555 0x555 0xf44e 0x9ea4 0x555 0x555 0xfbb5 0x9e44 0x555 0x555 0x1031c 0x9de1 0x555 0x555 0x10a83 0x9d84 0x599 0x599 0x111ea 0x9d24 0x599 0x599 0x11952 0x9c6d 0x599 0x599 0x120b9 0x9c13 0x599 0x599 0x12820 0x9bb9 0x599 0x599 0x12f87 0x9b59 0x599 0x599 0x136ee 0x9ae9 0x599 0x599 0x13e56 0x9a64 0x599 0x599 0x145bd 0x99d2 0x599 0x599 0x14d24 0x994d 0x599 0x599 0x1548b 0x98e0 0x599 0x599 0x15bf2 0x988d 0x599 0x599 0x1635a 0x983c 0x599 0x599 0x16ac1 0x97f5 0x599 0x599 0x17228 0x97b7 0x599 0x599 0x1798f 0x9776 0x599 0x599 0x180f6 0x9738 0x599 0x599 0x1885e 0x9700 0x599 0x599 0x18fc5 0x96c8 0x5b3 0x5b3 0x1972c 0x9693 0x5b3 0x5b3 0x19e93 0x965f 0x5b3 0x5b3 0x1a5fa 0x9602 0x5b3 0x5b3 0x1ad62 0x95d0 0x5b3 0x5b3 0x1b4c9 0x95a8 0x5b3 0x5b3 0x1bc30 0x957c 0x5b3 0x5b3 0x1c397 0x9554 0x5b3 0x5b3 0x1cafe 0x952f 0x5b3 0x5b3 0x1d266 0x950a 0x5b3 0x5b3 0x1d9cd 0x94e4 0x5b3 0x5b3 0x1e134 0x94c2 0x5b3 0x5b3 0x1e89b 0x94a0 0x5b3 0x5b3 0x1f002 0x9481 0x5c2 0x5c2 0x1f76a 0x9462 0x5c2 0x5c2 0x20638 0x943d 0x5c2 0x5c2 0x20d9f 0x9418 0x5c2 0x5c2 0x21506 0x93ec 0x5c2 0x5c2 0x21c6e 0x93b5 0x5c2 0x5c2 0x223d5 0x9383 0x5c2 0x5c2 0x22b3c 0x9355 0x5c2 0x5c2 0x232a3 0x9329 0x5c2 0x5c2 0x23a0a 0x92c3 0x5c2 0x5c2 0x24172 0x9297 0x5c2 0x5c2 0x248d9 0x926c 0x5c2 0x5c2 0x25040 0x924a 0x5c2 0x5c2 0x257a7 0x9222 0x5c2 0x5c2 0x25f0e 0x91f6 0x5c2 0x5c2 0x26676 0x91bb 0x5c2 0x5c2 0x26ddd 0x9177 0x5c2 0x5c2 0x27544 0x913c 0x5d1 0x5d1 0x27cab 0x9104 0x5d1 0x5d1 0x28412 0x90bd 0x5d1 0x5d1 0x28b7a 0x9066 0x5d1 0x5d1 0x292e1 0x903e 0x5d1 0x5d1 0x29a48 0x9032 0x5d1 0x5d1 0x2a1af 0x9025 0x5d1 0x5d1 0x2a916 0x9019 0x5d1 0x5d1 0x2b07e 0x9003 0x5e0 0x5e0 0x2b7e5 0x8fe4 0x5e0 0x5e0 0x2bf4c 0x8f87 0x5e0 0x5e0 0x2c6b3 0x8e42 0x5e0 0x5e0 0x2ce1a 0x8c51 0x5e0 0x5e0 0x2d582 0x89c6 0x5e0 0x5e0 0x2dce9 0x8634 0x5e0 0x5e0 0x2e450 0x8401 0x5e0 0x5e0>;
			battery1_profile_t5_num = <0x64>;
			battery1_profile_t5_col = <0x04>;
			battery1_profile_t5 = <0x00 0xad4b 0x490 0x490 0x767 0xacbd 0x490 0x490 0xece 0xac44 0x490 0x490 0x1636 0xabda 0x490 0x490 0x1d9d 0xab74 0x490 0x490 0x2504 0xab11 0x490 0x490 0x2c6b 0xaab1 0x490 0x490 0x33d2 0xaa4e 0x490 0x490 0x3b3a 0xa9e7 0x490 0x490 0x42a1 0xa981 0x490 0x490 0x4a08 0xa91b 0x490 0x490 0x516f 0xa8ab 0x490 0x490 0x58d6 0xa83f 0x490 0x490 0x603e 0xa7cc 0x490 0x490 0x67a5 0xa75c 0x490 0x490 0x6f0c 0xa6ea 0x490 0x490 0x7673 0xa674 0x490 0x490 0x7dda 0xa601 0x490 0x490 0x8542 0xa588 0x490 0x490 0x8ca9 0xa4a0 0x495 0x495 0x9410 0xa42d 0x495 0x495 0x9b77 0xa3b7 0x555 0x555 0xa2de 0xa347 0x555 0x555 0xaa46 0xa2d5 0x555 0x555 0xb1ad 0xa262 0x555 0x555 0xb914 0xa1f2 0x555 0x555 0xc07b 0xa186 0x555 0x555 0xc7e2 0xa116 0x555 0x555 0xcf4a 0xa0aa 0x555 0x555 0xd6b1 0xa040 0x555 0x555 0xde18 0x9fd4 0x555 0x555 0xe57f 0x9f6e 0x555 0x555 0xece6 0x9f0a 0x555 0x555 0xf44e 0x9ea4 0x555 0x555 0xfbb5 0x9e44 0x555 0x555 0x1031c 0x9de1 0x555 0x555 0x10a83 0x9d84 0x599 0x599 0x111ea 0x9d24 0x599 0x599 0x11952 0x9c6d 0x599 0x599 0x120b9 0x9c13 0x599 0x599 0x12820 0x9bb9 0x599 0x599 0x12f87 0x9b59 0x599 0x599 0x136ee 0x9ae9 0x599 0x599 0x13e56 0x9a64 0x599 0x599 0x145bd 0x99d2 0x599 0x599 0x14d24 0x994d 0x599 0x599 0x1548b 0x98e0 0x599 0x599 0x15bf2 0x988d 0x599 0x599 0x1635a 0x983c 0x599 0x599 0x16ac1 0x97f5 0x599 0x599 0x17228 0x97b7 0x599 0x599 0x1798f 0x9776 0x599 0x599 0x180f6 0x9738 0x599 0x599 0x1885e 0x9700 0x599 0x599 0x18fc5 0x96c8 0x5b3 0x5b3 0x1972c 0x9693 0x5b3 0x5b3 0x19e93 0x965f 0x5b3 0x5b3 0x1a5fa 0x9602 0x5b3 0x5b3 0x1ad62 0x95d0 0x5b3 0x5b3 0x1b4c9 0x95a8 0x5b3 0x5b3 0x1bc30 0x957c 0x5b3 0x5b3 0x1c397 0x9554 0x5b3 0x5b3 0x1cafe 0x952f 0x5b3 0x5b3 0x1d266 0x950a 0x5b3 0x5b3 0x1d9cd 0x94e4 0x5b3 0x5b3 0x1e134 0x94c2 0x5b3 0x5b3 0x1e89b 0x94a0 0x5b3 0x5b3 0x1f002 0x9481 0x5c2 0x5c2 0x1f76a 0x9462 0x5c2 0x5c2 0x20638 0x943d 0x5c2 0x5c2 0x20d9f 0x9418 0x5c2 0x5c2 0x21506 0x93ec 0x5c2 0x5c2 0x21c6e 0x93b5 0x5c2 0x5c2 0x223d5 0x9383 0x5c2 0x5c2 0x22b3c 0x9355 0x5c2 0x5c2 0x232a3 0x9329 0x5c2 0x5c2 0x23a0a 0x92c3 0x5c2 0x5c2 0x24172 0x9297 0x5c2 0x5c2 0x248d9 0x926c 0x5c2 0x5c2 0x25040 0x924a 0x5c2 0x5c2 0x257a7 0x9222 0x5c2 0x5c2 0x25f0e 0x91f6 0x5c2 0x5c2 0x26676 0x91bb 0x5c2 0x5c2 0x26ddd 0x9177 0x5c2 0x5c2 0x27544 0x913c 0x5d1 0x5d1 0x27cab 0x9104 0x5d1 0x5d1 0x28412 0x90bd 0x5d1 0x5d1 0x28b7a 0x9066 0x5d1 0x5d1 0x292e1 0x903e 0x5d1 0x5d1 0x29a48 0x9032 0x5d1 0x5d1 0x2a1af 0x9025 0x5d1 0x5d1 0x2a916 0x9019 0x5d1 0x5d1 0x2b07e 0x9003 0x5e0 0x5e0 0x2b7e5 0x8fe4 0x5e0 0x5e0 0x2bf4c 0x8f87 0x5e0 0x5e0 0x2c6b3 0x8e42 0x5e0 0x5e0 0x2ce1a 0x8c51 0x5e0 0x5e0 0x2d582 0x89c6 0x5e0 0x5e0 0x2dce9 0x8634 0x5e0 0x5e0 0x2e450 0x8401 0x5e0 0x5e0>;
		};
	};

	fragment@36 {
		target = <0xffffffff>;

		__overlay__ {

			cam0@0 {
				phandle = <0x31>;

				pins_cmd_dat {
					pinmux = <0x1400>;
					slew-rate = <0x01>;
					output-low;
				};
			};

			cam0@1 {
				phandle = <0x32>;

				pins_cmd_dat {
					pinmux = <0x1400>;
					slew-rate = <0x01>;
					output-high;
				};
			};

			cam0@2 {
				phandle = <0x33>;

				pins_cmd_dat {
					pinmux = <0x1300>;
					slew-rate = <0x01>;
					output-low;
				};
			};

			cam0@3 {
				phandle = <0x34>;

				pins_cmd_dat {
					pinmux = <0x1300>;
					slew-rate = <0x01>;
					output-high;
				};
			};

			cam0@4 {
				phandle = <0x35>;

				pins_cmd_dat {
					pinmux = <0x9800>;
					slew-rate = <0x01>;
					output-low;
				};
			};

			cam0@5 {
				phandle = <0x36>;

				pins_cmd_dat {
					pinmux = <0x9800>;
					slew-rate = <0x01>;
					output-high;
				};
			};

			cam0_vcamaf@0 {
				phandle = <0x37>;

				pins_cmd_dat {
					pinmux = <0x3e00>;
					slew-rate = <0x01>;
					output-low;
				};
			};

			cam0_vcamaf@1 {
				phandle = <0x38>;

				pins_cmd_dat {
					pinmux = <0x3e00>;
					slew-rate = <0x01>;
					output-high;
				};
			};

			cam1@0 {
				phandle = <0x39>;

				pins_cmd_dat {
					pinmux = <0x1000>;
					slew-rate = <0x01>;
					output-low;
				};
			};

			cam1@1 {
				phandle = <0x3a>;

				pins_cmd_dat {
					pinmux = <0x1000>;
					slew-rate = <0x01>;
					output-high;
				};
			};

			cam1@2 {
				phandle = <0x3b>;
			};

			cam1@3 {
				phandle = <0x3c>;
			};

			cam1@4 {
				phandle = <0x3d>;

				pins_cmd_dat {
					pinmux = <0x9600>;
					slew-rate = <0x01>;
					output-low;
				};
			};

			cam1@5 {
				phandle = <0x3e>;

				pins_cmd_dat {
					pinmux = <0x9600>;
					slew-rate = <0x01>;
					output-high;
				};
			};

			cam2@0 {
				phandle = <0x3f>;

				pins_cmd_dat {
					pinmux = <0x1200>;
					slew-rate = <0x01>;
					output-low;
				};
			};

			cam2@1 {
				phandle = <0x40>;

				pins_cmd_dat {
					pinmux = <0x1200>;
					slew-rate = <0x01>;
					output-high;
				};
			};

			cam2@2 {
				phandle = <0x41>;

				pins_cmd_dat {
					pinmux = <0x1100>;
					slew-rate = <0x01>;
					output-low;
				};
			};

			cam2@3 {
				phandle = <0x42>;

				pins_cmd_dat {
					pinmux = <0x1100>;
					slew-rate = <0x01>;
					output-high;
				};
			};

			cam2@4 {
				phandle = <0x43>;

				pins_cmd_dat {
					pinmux = <0x9800>;
					slew-rate = <0x01>;
					output-low;
				};
			};

			cam2@5 {
				phandle = <0x44>;

				pins_cmd_dat {
					pinmux = <0x9800>;
					slew-rate = <0x01>;
					output-high;
				};
			};

			cam2_vcamaf@0 {
				phandle = <0x45>;

				pins_cmd_dat {
					pinmux = <0x3e00>;
					slew-rate = <0x01>;
					output-low;
				};
			};

			cam2_vcamaf@1 {
				phandle = <0x46>;

				pins_cmd_dat {
					pinmux = <0x3e00>;
					slew-rate = <0x01>;
					output-high;
				};
			};

			cam3@0 {
				phandle = <0x47>;

				pins_cmd_dat {
					pinmux = <0x1600>;
					slew-rate = <0x01>;
					output-low;
				};
			};

			cam3@1 {
				phandle = <0x48>;

				pins_cmd_dat {
					pinmux = <0x1600>;
					slew-rate = <0x01>;
					output-high;
				};
			};

			cam3@2 {
				phandle = <0x49>;

				pins_cmd_dat {
					pinmux = <0x1500>;
					slew-rate = <0x01>;
					output-low;
				};
			};

			cam3@3 {
				phandle = <0x4a>;

				pins_cmd_dat {
					pinmux = <0x1500>;
					slew-rate = <0x01>;
					output-high;
				};
			};

			cam3@4 {
				phandle = <0x4b>;

				pins_cmd_dat {
					pinmux = <0x9600>;
					slew-rate = <0x01>;
					output-low;
				};
			};

			cam3@5 {
				phandle = <0x4c>;

				pins_cmd_dat {
					pinmux = <0x9600>;
					slew-rate = <0x01>;
					output-high;
				};
			};

			camera_pins_cam0_mclk_off {
				phandle = <0x4d>;

				pins_cmd_dat {
					pinmux = <0x8000>;
					drive-strength = <0x01>;
				};
			};

			camera_pins_cam0_mclk_2ma {
				phandle = <0x4e>;

				pins_cmd_dat {
					pinmux = <0x8001>;
					drive-strength = <0x00>;
				};
			};

			camera_pins_cam0_mclk_4ma {
				phandle = <0x4f>;

				pins_cmd_dat {
					pinmux = <0x8001>;
					drive-strength = <0x01>;
				};
			};

			camera_pins_cam0_mclk_6ma {
				phandle = <0x50>;

				pins_cmd_dat {
					pinmux = <0x8001>;
					drive-strength = <0x02>;
				};
			};

			camera_pins_cam0_mclk_8ma {
				phandle = <0x51>;

				pins_cmd_dat {
					pinmux = <0x8001>;
					drive-strength = <0x03>;
				};
			};

			camera_pins_cam1_mclk_off {
				phandle = <0x52>;

				pins_cmd_dat {
					pinmux = <0x7e00>;
					drive-strength = <0x01>;
				};
			};

			camera_pins_cam1_mclk_2ma {
				phandle = <0x53>;

				pins_cmd_dat {
					pinmux = <0x7e01>;
					drive-strength = <0x00>;
				};
			};

			camera_pins_cam1_mclk_4ma {
				phandle = <0x54>;

				pins_cmd_dat {
					pinmux = <0x7e01>;
					drive-strength = <0x01>;
				};
			};

			camera_pins_cam1_mclk_6ma {
				phandle = <0x55>;

				pins_cmd_dat {
					pinmux = <0x7e01>;
					drive-strength = <0x02>;
				};
			};

			camera_pins_cam1_mclk_8ma {
				phandle = <0x56>;

				pins_cmd_dat {
					pinmux = <0x7e01>;
					drive-strength = <0x03>;
				};
			};

			camera_pins_cam2_mclk_off {
				phandle = <0x57>;

				pins_cmd_dat {
					pinmux = <0x7f00>;
					drive-strength = <0x01>;
				};
			};

			camera_pins_cam2_mclk_2ma {
				phandle = <0x58>;

				pins_cmd_dat {
					pinmux = <0x7f01>;
					drive-strength = <0x00>;
				};
			};

			camera_pins_cam2_mclk_4ma {
				phandle = <0x59>;

				pins_cmd_dat {
					pinmux = <0x7f01>;
					drive-strength = <0x01>;
				};
			};

			camera_pins_cam2_mclk_6ma {
				phandle = <0x5a>;

				pins_cmd_dat {
					pinmux = <0x7f01>;
					drive-strength = <0x02>;
				};
			};

			camera_pins_cam2_mclk_8ma {
				phandle = <0x5b>;

				pins_cmd_dat {
					pinmux = <0x7f01>;
					drive-strength = <0x03>;
				};
			};

			camera_pins_cam3_mclk_off {
				phandle = <0x5c>;

				pins_cmd_dat {
					pinmux = <0x8100>;
					drive-strength = <0x01>;
				};
			};

			camera_pins_cam3_mclk_2ma {
				phandle = <0x5d>;

				pins_cmd_dat {
					pinmux = <0x8101>;
					drive-strength = <0x00>;
				};
			};

			camera_pins_cam3_mclk_4ma {
				phandle = <0x5e>;

				pins_cmd_dat {
					pinmux = <0x8101>;
					drive-strength = <0x01>;
				};
			};

			camera_pins_cam3_mclk_6ma {
				phandle = <0x5f>;

				pins_cmd_dat {
					pinmux = <0x8101>;
					drive-strength = <0x02>;
				};
			};

			camera_pins_cam3_mclk_8ma {
				phandle = <0x60>;

				pins_cmd_dat {
					pinmux = <0x8101>;
					drive-strength = <0x03>;
				};
			};

			cam_mipi_switch_en_off@0 {
				phandle = <0x61>;

				pins_cmd_dat {
					pinmux = <0x9900>;
					slew-rate = <0x01>;
					output-low;
				};
			};

			cam_mipi_switch_en_on@1 {
				phandle = <0x62>;

				pins_cmd_dat {
					pinmux = <0x9900>;
					slew-rate = <0x01>;
					output-high;
				};
			};

			cam_mipi_switch_sel_off@0 {
				phandle = <0x63>;

				pins_cmd_dat {
					pinmux = <0x9b00>;
					slew-rate = <0x01>;
					output-low;
				};
			};

			cam_mipi_switch_sel_on@1 {
				phandle = <0x64>;

				pins_cmd_dat {
					pinmux = <0x9b00>;
					slew-rate = <0x01>;
					output-high;
				};
			};

			camdefault {
				phandle = <0x30>;
			};
		};
	};

	fragment@37 {
		target = <0xffffffff>;

		__overlay__ {
			pinctrl-names = "default\0cam0_rst0\0cam0_rst1\0cam0_pnd0\0cam0_pnd1\0cam0_ldo_vcamio_0\0cam0_ldo_vcamio_1\0cam0_ldo_vcamafvdd_0\0cam0_ldo_vcamafvdd_1\0cam1_rst0\0cam1_rst1\0cam1_pnd0\0cam1_pnd1\0cam1_ldo_vcamio_0\0cam1_ldo_vcamio_1\0cam2_rst0\0cam2_rst1\0cam2_pnd0\0cam2_pnd1\0cam2_ldo_vcamio_0\0cam2_ldo_vcamio_1\0cam2_ldo_vcamafvdd_0\0cam2_ldo_vcamafvdd_1\0cam3_rst0\0cam3_rst1\0cam3_pnd0\0cam3_pnd1\0cam3_ldo_vcamio_0\0cam3_ldo_vcamio_1\0cam0_mclk_off\0cam0_mclk_2mA\0cam0_mclk_4mA\0cam0_mclk_6mA\0cam0_mclk_8mA\0cam1_mclk_off\0cam1_mclk_2mA\0cam1_mclk_4mA\0cam1_mclk_6mA\0cam1_mclk_8mA\0cam2_mclk_off\0cam2_mclk_2mA\0cam2_mclk_4mA\0cam2_mclk_6mA\0cam2_mclk_8mA\0cam3_mclk_off\0cam3_mclk_2mA\0cam3_mclk_4mA\0cam3_mclk_6mA\0cam3_mclk_8mA\0cam_mipi_switch_en_0\0cam_mipi_switch_en_1\0cam_mipi_switch_sel_0\0cam_mipi_switch_sel_1";
			pinctrl-0 = <0x30>;
			pinctrl-1 = <0x31>;
			pinctrl-2 = <0x32>;
			pinctrl-3 = <0x33>;
			pinctrl-4 = <0x34>;
			pinctrl-5 = <0x35>;
			pinctrl-6 = <0x36>;
			pinctrl-7 = <0x37>;
			pinctrl-8 = <0x38>;
			pinctrl-9 = <0x39>;
			pinctrl-10 = <0x3a>;
			pinctrl-11 = <0x3b>;
			pinctrl-12 = <0x3c>;
			pinctrl-13 = <0x3d>;
			pinctrl-14 = <0x3e>;
			pinctrl-15 = <0x3f>;
			pinctrl-16 = <0x40>;
			pinctrl-17 = <0x41>;
			pinctrl-18 = <0x42>;
			pinctrl-19 = <0x43>;
			pinctrl-20 = <0x44>;
			pinctrl-21 = <0x45>;
			pinctrl-22 = <0x46>;
			pinctrl-23 = <0x47>;
			pinctrl-24 = <0x48>;
			pinctrl-25 = <0x49>;
			pinctrl-26 = <0x4a>;
			pinctrl-27 = <0x4b>;
			pinctrl-28 = <0x4c>;
			pinctrl-29 = <0x4d>;
			pinctrl-30 = <0x4e>;
			pinctrl-31 = <0x4f>;
			pinctrl-32 = <0x50>;
			pinctrl-33 = <0x51>;
			pinctrl-34 = <0x52>;
			pinctrl-35 = <0x53>;
			pinctrl-36 = <0x54>;
			pinctrl-37 = <0x55>;
			pinctrl-38 = <0x56>;
			pinctrl-39 = <0x57>;
			pinctrl-40 = <0x58>;
			pinctrl-41 = <0x59>;
			pinctrl-42 = <0x5a>;
			pinctrl-43 = <0x5b>;
			pinctrl-44 = <0x5c>;
			pinctrl-45 = <0x5d>;
			pinctrl-46 = <0x5e>;
			pinctrl-47 = <0x5f>;
			pinctrl-48 = <0x60>;
			pinctrl-49 = <0x61>;
			pinctrl-50 = <0x62>;
			pinctrl-51 = <0x63>;
			pinctrl-52 = <0x64>;
			cam0_pin_mclk = "mclk";
			cam0_pin_rst = "gpio";
			cam0_pin_pdn = "gpio";
			cam0_pin_vcama = "aw37004dnr";
			cam0_pin_vcamio = "gpio";
			cam0_pin_vcamaf = "gpio";
			cam0_pin_vcamd = "aw37004dnr";
			cam1_pin_mclk = "mclk";
			cam1_pin_rst = "gpio";
			cam1_pin_pdn = "gpio";
			cam1_pin_vcama = "aw37004dnr";
			cam1_pin_vcamio = "gpio";
			cam1_pin_vcamd = "aw37004dnr";
			cam2_pin_mclk = "mclk";
			cam2_pin_rst = "gpio";
			cam2_pin_pdn = "gpio";
			cam2_pin_vcama = "aw37004dnr";
			cam2_pin_vcamio = "gpio";
			cam2_pin_vcamaf = "gpio";
			cam2_pin_vcamd = "aw37004dnr";
			cam3_pin_mclk = "mclk";
			cam3_pin_rst = "gpio";
			cam3_pin_pdn = "gpio";
			cam3_pin_vcama = "aw37004dnr";
			cam3_pin_vcamio = "gpio";
			cam3_pin_vcamd = "aw37004dnr";
			cam1_pin_mipi_switch_en = "gpio";
			cam1_pin_mipi_switch_sel = "gpio";
			cam3_pin_mipi_switch_en = "gpio";
			cam3_pin_mipi_switch_sel = "gpio";
			status = "okay";
		};
	};

	fragment@38 {
		target = <0xffffffff>;

		__overlay__ {
			status = "okay";
			clock-frequency = <0x61a80>;
			#address-cells = <0x01>;
			#size-cells = <0x00>;

			camera_sub@1a {
				compatible = "mediatek,camera_sub";
				#thermal-sensor-cells = <0x00>;
				reg = <0x1a>;
				status = "okay";
				phandle = <0x6f>;
			};

			camera_main_two@1b {
				compatible = "mediatek,camera_main_two";
				#thermal-sensor-cells = <0x00>;
				reg = <0x1b>;
				status = "okay";
				phandle = <0x70>;
			};

			camera_main_two_af@1c {
				compatible = "mediatek,camera_main_two_af";
				#thermal-sensor-cells = <0x00>;
				reg = <0x1c>;
				status = "okay";
				phandle = <0x71>;
			};
		};
	};

	fragment@39 {
		target = <0xffffffff>;

		__overlay__ {
			status = "okay";
			clock-frequency = <0x61a80>;
			#address-cells = <0x01>;
			#size-cells = <0x00>;

			camera_main_af@72 {
				compatible = "mediatek,CAMERA_MAIN_AF";
				reg = <0x72>;
				status = "okay";
				phandle = <0x72>;
			};

			camera_eeprom0@50 {
				compatible = "mediatek,camera_eeprom";
				reg = <0x50>;
				status = "okay";
				phandle = <0x73>;
			};

			camera_main@1a {
				compatible = "mediatek,camera_main";
				#thermal-sensor-cells = <0x00>;
				reg = <0x1a>;
				status = "okay";
				phandle = <0x74>;
			};

			camera_sub_two@73 {
				compatible = "mediatek,camera_sub_two";
				reg = <0x73>;
				status = "okay";
				phandle = <0x75>;
			};
		};
	};

	fragment@40 {
		target = <0xffffffff>;

		__overlay__ {
			main = <0x03 0x00 0x00 0x01 0x00>;
			sub = <0x04 0x00 0x00 0x02 0x00>;
			main2 = <0x03 0x00 0x00 0x01 0x00>;
			sub2 = <0x04 0x00 0x00 0x02 0x00>;
			main3 = <0x00 0x00 0x00 0x00 0x00>;
			sub3 = <0x00 0x00 0x00 0x00 0x00>;
			status = "okay";
		};
	};

	fragment@41 {
		target = <0xffffffff>;

		__overlay__ {

			aw37004dnr@28 {
				compatible = "aw37004dnr,regulator";
				reg = <0x28>;
				status = "okay";
			};
		};
	};

	fragment@42 {
		target = <0xffffffff>;

		__overlay__ {

			aw36515_flashlight@49 {
				compatible = "awinic,aw36515_flashlight";
				reg = <0x49>;
				status = "okay";
			};
		};
	};

	fragment@43 {
		target = <0xffffffff>;

		__overlay__ {

			aw36515_leds@51 {
				compatible = "awinic,aw36515_led";
				reg = <0x51>;
				status = "okay";

				aw36515,infrared {
					aw36515,name = "infrared";
					aw36515,max-brightness = <0x03>;
				};
			};
		};
	};

	fragment@44 {
		target = <0xffffffff>;

		__overlay__ {

			mmc0default {
				phandle = <0x76>;

				pins_cmd_dat {
					pinmux = <0x3a01 0x3b01 0x3c01 0x3d01 0x3f01 0x4001 0x4101 0x3801>;
					input-enable;
					drive-strength = <0x06>;
					bias-pull-up = <0x65>;
				};

				pins_clk {
					pinmux = <0x3701>;
					drive-strength = <0x05>;
					bias-pull-down = <0x66>;
				};

				pins_rst {
					pinmux = <0x3901>;
					drive-strength = <0x04>;
					bias-pull-up = <0x64>;
				};
			};

			mmc0@0 {
				phandle = <0x77>;

				pins_cmd_dat {
					pinmux = <0x3a01 0x3b01 0x3c01 0x3d01 0x3f01 0x4001 0x4101 0x3801>;
					input-enable;
					drive-strength = <0x06>;
					bias-pull-up = <0x65>;
				};

				pins_clk {
					pinmux = <0x3701>;
					drive-strength = <0x05>;
					bias-pull-down = <0x66>;
				};

				pins_ds {
					pinmux = <0x3601>;
					drive-strength = <0x04>;
					bias-pull-down = <0x66>;
				};

				pins_rst {
					pinmux = <0x3901>;
					drive-strength = <0x04>;
					bias-pull-up = <0x64>;
				};
			};

			mmc0@1 {
				phandle = <0x78>;

				pins_cmd_dat {
					pinmux = <0x3a01 0x3b01 0x3c01 0x3d01 0x3f01 0x4001 0x4101 0x3801>;
					input-enable;
					drive-strength = <0x04>;
					bias-pull-down = <0x66>;
				};

				pins_clk {
					pinmux = <0x3701>;
					drive-strength = <0x04>;
					bias-pull-down = <0x66>;
				};

				pins_rst {
					pinmux = <0x3901>;
					drive-strength = <0x04>;
					bias-pull-up = <0x64>;
				};
			};
		};
	};

	fragment@45 {
		target = <0xffffffff>;

		__overlay__ {

			aw37501@3e {
				compatible = "mediatek,i2c_lcd_bias";
				reg = <0x3e>;
				id = <0x09>;
				status = "okay";
				phandle = <0x79>;
			};

			it6112@56 {
				compatible = "chamsion,it6112";
				reg = <0x56>;
				id = <0x09>;
				status = "okay";
				phandle = <0x7a>;
			};
		};
	};

	fragment@46 {
		target = <0xffffffff>;

		__overlay__ {

			sh36610x@55 {
				compatible = "sw,SH366002";
				reg = <0x55>;
				status = "okay";
			};
		};
	};

	fragment@47 {
		target = <0xffffffff>;

		__overlay__ {

			focaltech@0 {
				compatible = "focaltech,fts";
				reg = <0x00>;
				spi-max-frequency = <0x5b8d80>;
				interrupt-parent = <0xffffffff>;
				interrupts = <0x09 0x02 0x09 0x00>;
				focaltech,reset-gpio = <0xffffffff 0x78 0x00>;
				focaltech,irq-gpio = <0xffffffff 0x09 0x00>;
				focaltech,max-touch-number = <0x0a>;
				focaltech,display-coords = <0x00 0x00 0x4b0 0x780>;
				chipone,rst-gpio = <0xffffffff 0x78 0x00>;
				chipone,irq-gpio = <0xffffffff 0x09 0x00>;
				chipone,x-res = <0x4b0>;
				chipone,y-res = <0x780>;
				chipone,touch-charger-detect-enable;
				chipone,touch-charger-detect-type = "notify";
				chipone,touch-charger-detect-psy-name = "charger";
				chipone,touch-charger-detect-psp = "POWER_SUPPLY_PROP_ONLINE";
				chipone,touch-charger-detect-psp-poll-interval = <0x3e8>;
				chipone,touch-earjack-detect-enable;
				chipone,touch-earjack-state-filepath = "/sys/bus/platform/drivers/Accdet_Driver/state";
				chipone,touch-earjack-poll-interval = <0x3e8>;
				chipone,test-reset-pin;
				chipone,test-int-pin;
				chipone,test-rawdata;
				chipone,test-rawdata-frames = <0x01>;
				chipone,rawdata-min = <0x64>;
				chipone,rawdata-max = <0x2710>;
				chipone,test-noise;
				chipone,test-noise-frames = <0x32>;
				chipone,noise-max = <0x3e8>;
				chipone,test-open;
				chipone,open-min = <0xc8>;
				chipone,test-short;
				chipone,short-min = <0xc8>;
				chipone,test-compensate-cap;
				chipone,compensate-cap-min = <0x01>;
				chipone,compensate-cap-max = <0x7f>;
				chipone,test-gesture-rawdata;
				chipone,test-gesture-rawdata-frames = <0x01>;
				chipone,gesture-rawdata-min = <0x64>;
				chipone,gesture-rawdata-max = <0x2710>;
				chipone,test-gesture-lp-rawdata;
				chipone,test-gesture-lp-rawdata-frames = <0x01>;
				chipone,gesture-lp-rawdata-min = <0x64>;
				chipone,gesture-lp-rawdata-max = <0x2710>;
				chipone,test-gesture-noise;
				chipone,test-gesture-noise-frames = <0x32>;
				chipone,gesture-noise-max = <0x3e8>;
				chipone,test-gesture-lp-noise;
				chipone,test-gesture-lp-noise-frames = <0x32>;
				chipone,gesture-lp-noise-max = <0x3e8>;
				status = "okay";
			};
		};
	};

	fragment@48 {
		target = <0xffffffff>;

		__overlay__ {
			GPIO_SIM1_HOT_PLUG = <0xffffffff 0x17 0x00>;
			GPIO_FDD_BAND_SUPPORT_DETECT_3RD_PIN = <0xffffffff 0x19 0x00>;
			GPIO_FDD_BAND_SUPPORT_DETECT_2ND_PIN = <0xffffffff 0x1a 0x00>;
			GPIO_FDD_BAND_SUPPORT_DETECT_1ST_PIN = <0xffffffff 0x1b 0x00>;
			GPIO_SIM1_SCLK = <0xffffffff 0x4d 0x00>;
			GPIO_SIM1_SRST = <0xffffffff 0x4e 0x00>;
			GPIO_SIM1_SIO = <0xffffffff 0x4f 0x00>;
			GPIO_SIM2_SCLK = <0xffffffff 0x50 0x00>;
			GPIO_SIM2_SRST = <0xffffffff 0x51 0x00>;
			GPIO_SIM2_SIO = <0xffffffff 0x52 0x00>;
		};
	};

	fragment@49 {
		target = <0xffffffff>;

		__overlay__ {
			gpio_init_default = <0x00 0x00 0x00 0x00 0x01 0x01 0x01 0x01 0x02 0x00 0x00 0x01 0x00 0x01 0x02 0x02 0x00 0x00 0x01 0x00 0x01 0x03 0x02 0x00 0x00 0x01 0x00 0x01 0x04 0x02 0x00 0x00 0x00 0x00 0x01 0x05 0x00 0x00 0x00 0x01 0x01 0x01 0x06 0x00 0x00 0x00 0x01 0x01 0x01 0x07 0x00 0x00 0x00 0x01 0x01 0x01 0x08 0x00 0x00 0x00 0x01 0x00 0x01 0x09 0x00 0x00 0x00 0x01 0x01 0x01 0x0a 0x00 0x00 0x00 0x01 0x00 0x01 0x0b 0x00 0x00 0x00 0x01 0x01 0x01 0x0c 0x00 0x00 0x00 0x01 0x00 0x01 0x0d 0x00 0x01 0x00 0x01 0x00 0x01 0x0e 0x00 0x00 0x00 0x01 0x01 0x00 0x0f 0x00 0x00 0x00 0x01 0x00 0x00 0x10 0x00 0x01 0x00 0x01 0x00 0x00 0x11 0x00 0x01 0x00 0x01 0x00 0x00 0x12 0x00 0x01 0x00 0x01 0x00 0x00 0x13 0x00 0x01 0x00 0x01 0x00 0x00 0x14 0x00 0x01 0x00 0x01 0x00 0x00 0x15 0x00 0x01 0x00 0x01 0x00 0x00 0x16 0x00 0x01 0x00 0x01 0x00 0x00 0x17 0x01 0x00 0x00 0x01 0x01 0x00 0x18 0x00 0x00 0x00 0x01 0x01 0x00 0x19 0x00 0x00 0x00 0x01 0x00 0x00 0x1a 0x00 0x00 0x00 0x01 0x00 0x00 0x1b 0x00 0x00 0x00 0x01 0x00 0x00 0x1c 0x01 0x00 0x00 0x01 0x01 0x01 0x1d 0x01 0x00 0x00 0x00 0x00 0x01 0x1e 0x01 0x00 0x00 0x00 0x00 0x01 0x1f 0x01 0x00 0x00 0x00 0x00 0x01 0x20 0x01 0x00 0x00 0x00 0x00 0x01 0x21 0x01 0x00 0x00 0x00 0x00 0x01 0x22 0x01 0x00 0x00 0x01 0x00 0x00 0x23 0x00 0x01 0x01 0x01 0x00 0x00 0x24 0x01 0x00 0x00 0x00 0x00 0x00 0x25 0x00 0x01 0x01 0x01 0x00 0x00 0x26 0x02 0x00 0x00 0x00 0x00 0x01 0x27 0x02 0x00 0x00 0x00 0x00 0x01 0x28 0x02 0x00 0x00 0x00 0x00 0x01 0x29 0x02 0x00 0x00 0x01 0x00 0x01 0x2a 0x04 0x00 0x00 0x01 0x01 0x00 0x2b 0x00 0x01 0x00 0x01 0x00 0x00 0x2c 0x04 0x00 0x00 0x01 0x01 0x00 0x2d 0x04 0x00 0x00 0x00 0x00 0x00 0x2e 0x01 0x00 0x00 0x01 0x00 0x00 0x2f 0x01 0x00 0x00 0x01 0x00 0x00 0x30 0x01 0x00 0x00 0x00 0x00 0x00 0x31 0x01 0x00 0x00 0x01 0x00 0x00 0x32 0x02 0x00 0x00 0x00 0x00 0x01 0x33 0x02 0x00 0x00 0x00 0x00 0x01 0x34 0x02 0x00 0x00 0x00 0x00 0x01 0x35 0x02 0x00 0x00 0x01 0x00 0x01 0x3e 0x00 0x01 0x00 0x01 0x00 0x01 0x40 0x00 0x01 0x00 0x01 0x00 0x01 0x41 0x00 0x01 0x00 0x01 0x00 0x01 0x42 0x01 0x00 0x00 0x01 0x01 0x00 0x43 0x01 0x00 0x00 0x01 0x01 0x01 0x44 0x01 0x00 0x00 0x00 0x00 0x01 0x45 0x00 0x00 0x00 0x01 0x01 0x01 0x4d 0x01 0x00 0x00 0x00 0x00 0x01 0x4e 0x01 0x00 0x00 0x00 0x00 0x01 0x4f 0x01 0x00 0x00 0x01 0x01 0x01 0x50 0x01 0x00 0x00 0x00 0x00 0x01 0x51 0x01 0x00 0x00 0x00 0x00 0x01 0x52 0x01 0x00 0x00 0x01 0x01 0x01 0x53 0x01 0x00 0x00 0x01 0x00 0x01 0x54 0x01 0x00 0x00 0x00 0x00 0x01 0x55 0x01 0x00 0x00 0x00 0x00 0x01 0x56 0x02 0x00 0x00 0x01 0x00 0x00 0x57 0x01 0x00 0x00 0x01 0x00 0x00 0x58 0x01 0x00 0x00 0x01 0x00 0x00 0x59 0x02 0x00 0x00 0x01 0x00 0x00 0x5a 0x01 0x00 0x00 0x01 0x00 0x00 0x5b 0x01 0x00 0x00 0x01 0x00 0x00 0x5c 0x01 0x00 0x00 0x01 0x00 0x00 0x5d 0x01 0x00 0x00 0x01 0x00 0x00 0x5e 0x01 0x00 0x00 0x01 0x00 0x00 0x5f 0x00 0x01 0x00 0x01 0x00 0x00 0x60 0x01 0x00 0x00 0x01 0x00 0x00 0x61 0x01 0x00 0x00 0x01 0x00 0x00 0x62 0x01 0x00 0x00 0x01 0x00 0x00 0x63 0x01 0x00 0x00 0x01 0x00 0x00 0x64 0x00 0x01 0x00 0x01 0x00 0x00 0x65 0x00 0x01 0x00 0x01 0x00 0x00 0x66 0x00 0x00 0x00 0x01 0x00 0x00 0x67 0x00 0x01 0x00 0x01 0x00 0x00 0x68 0x02 0x00 0x00 0x00 0x00 0x00 0x69 0x00 0x01 0x00 0x01 0x00 0x00 0x6a 0x00 0x00 0x00 0x01 0x01 0x00 0x6b 0x00 0x01 0x00 0x01 0x00 0x00 0x6c 0x00 0x01 0x00 0x01 0x00 0x00 0x6d 0x01 0x00 0x00 0x01 0x00 0x00 0x6e 0x00 0x01 0x01 0x01 0x00 0x00 0x6f 0x00 0x01 0x00 0x01 0x00 0x00 0x70 0x01 0x00 0x00 0x00 0x00 0x00 0x71 0x01 0x00 0x00 0x01 0x00 0x00 0x72 0x00 0x01 0x00 0x01 0x00 0x00 0x73 0x00 0x01 0x00 0x01 0x00 0x00 0x74 0x01 0x00 0x00 0x00 0x00 0x00 0x75 0x01 0x00 0x00 0x01 0x00 0x00 0x76 0x00 0x01 0x00 0x01 0x00 0x00 0x77 0x00 0x01 0x00 0x01 0x00 0x00 0x78 0x00 0x01 0x00 0x01 0x00 0x00 0x79 0x00 0x01 0x00 0x01 0x00 0x00 0x7a 0x01 0x00 0x00 0x00 0x00 0x00 0x7b 0x01 0x00 0x00 0x00 0x00 0x00 0x7c 0x01 0x00 0x00 0x01 0x00 0x00 0x7d 0x01 0x00 0x00 0x01 0x00 0x00 0x7e 0x00 0x01 0x00 0x01 0x00 0x00 0x7f 0x00 0x01 0x00 0x01 0x00 0x00 0x80 0x00 0x01 0x00 0x01 0x00 0x00 0x81 0x00 0x01 0x00 0x01 0x00 0x00 0x82 0x01 0x00 0x00 0x01 0x01 0x01 0x83 0x01 0x00 0x00 0x01 0x01 0x01 0x84 0x02 0x00 0x00 0x01 0x01 0x00 0x85 0x02 0x00 0x00 0x01 0x01 0x00 0x86 0x01 0x00 0x00 0x01 0x01 0x01 0x87 0x01 0x00 0x00 0x01 0x01 0x01 0x88 0x01 0x00 0x00 0x01 0x01 0x01 0x89 0x01 0x00 0x00 0x01 0x01 0x01 0x8a 0x01 0x00 0x00 0x01 0x01 0x01 0x8b 0x01 0x00 0x00 0x01 0x01 0x01 0x8c 0x01 0x00 0x00 0x01 0x01 0x01 0x8d 0x01 0x00 0x00 0x01 0x01 0x01 0x8e 0x01 0x00 0x00 0x01 0x01 0x01 0x8f 0x01 0x00 0x00 0x01 0x01 0x01 0x90 0x01 0x00 0x00 0x01 0x01 0x01 0x91 0x01 0x00 0x00 0x01 0x01 0x01 0x92 0x01 0x00 0x00 0x01 0x01 0x01 0x93 0x01 0x00 0x00 0x01 0x01 0x01 0x94 0x01 0x00 0x00 0x01 0x01 0x01 0x95 0x01 0x00 0x00 0x01 0x01 0x01 0x96 0x00 0x01 0x00 0x01 0x00 0x01 0x97 0x00 0x01 0x01 0x01 0x00 0x01 0x98 0x00 0x01 0x00 0x01 0x00 0x01 0x99 0x00 0x01 0x00 0x01 0x00 0x01 0x9a 0x00 0x01 0x00 0x01 0x00 0x01 0x9b 0x00 0x01 0x00 0x01 0x00 0x01 0x9c 0x00 0x01 0x00 0x01 0x00 0x01 0x9d 0x00 0x01 0x00 0x01 0x00 0x01 0x9e 0x00 0x01 0x00 0x01 0x00 0x00 0x9f 0x00 0x01 0x00 0x01 0x00 0x00 0xa0 0x01 0x00 0x00 0x00 0x00 0x01 0xa1 0x01 0x00 0x00 0x00 0x00 0x01 0xa2 0x01 0x00 0x00 0x00 0x00 0x01 0xa3 0x01 0x00 0x00 0x01 0x00 0x01 0xa4 0x01 0x00 0x00 0x00 0x00 0x01 0xa5 0x01 0x00 0x00 0x00 0x00 0x01 0xa6 0x01 0x00 0x00 0x00 0x00 0x01 0xa7 0x01 0x00 0x00 0x01 0x00 0x01 0xa8 0x01 0x00 0x00 0x00 0x00 0x00 0xa9 0x01 0x00 0x00 0x00 0x00 0x01 0xaa 0x01 0x00 0x00 0x00 0x00 0x01 0xab 0x01 0x00 0x00 0x00 0x00 0x01 0xac 0x01 0x00 0x00 0x00 0x00 0x01 0xad 0x01 0x00 0x00 0x01 0x00 0x01 0xae 0x01 0x00 0x00 0x01 0x00 0x01 0xaf 0x01 0x00 0x00 0x01 0x00 0x01 0xb0 0x01 0x00 0x00 0x01 0x00 0x01 0xb1 0x00 0x00 0x00 0x01 0x00 0x00 0xb2 0x00 0x00 0x00 0x01 0x00 0x00 0xb3 0x00 0x00 0x00 0x01 0x00 0x00 0xb4 0x00 0x00 0x00 0x01 0x00 0x00 0xb5 0x00 0x00 0x00 0x01 0x00 0x00 0xb6 0x00 0x00 0x00 0x01 0x00 0x00 0xb7 0x00 0x00 0x00 0x01 0x00 0x00 0xb8 0x00 0x00 0x00 0x01 0x00 0x00 0xb9 0x00 0x00 0x00 0x01 0x00 0x00 0xba 0x01 0x00 0x00 0x01 0x01 0x01 0xbb 0x01 0x00 0x00 0x01 0x01 0x01 0xbc 0x00 0x00 0x00 0x01 0x00 0x00 0xbd 0x00 0x00 0x00 0x01 0x00 0x00 0xbe 0x00 0x00 0x00 0x01 0x00 0x00 0xbf 0x00 0x00 0x00 0x01 0x00 0x00 0xc0 0x00 0x00 0x00 0x01 0x00 0x00 0xc1 0x00 0x00 0x00 0x01 0x00 0x00 0xc2 0x00 0x00 0x00 0x01 0x00 0x00 0xc3 0x00 0x00 0x00 0x01 0x00 0x00 0xc4 0x00 0x00 0x00 0x01 0x00 0x00 0xc5 0x00 0x00 0x00 0x01 0x00 0x00 0xc6 0x00 0x00 0x00 0x01 0x00 0x00 0xc7 0x00 0x00 0x00 0x01 0x00 0x00 0xc8 0x00 0x00 0x00 0x01 0x00 0x00 0xc9 0x00 0x00 0x00 0x01 0x00 0x00 0xca 0x00 0x00 0x00 0x01 0x00 0x00 0xcb 0x00 0x00 0x00 0x01 0x00 0x00 0xcc 0x00 0x00 0x00 0x01 0x00 0x00 0xcd 0x00 0x00 0x00 0x01 0x00 0x00 0xce 0x00 0x00 0x00 0x01 0x00 0x00 0xcf 0x00 0x00 0x00 0x01 0x00 0x00 0xd0 0x00 0x00 0x00 0x01 0x00 0x00 0xd1 0x00 0x00 0x00 0x01 0x00 0x00 0xd2 0x00 0x00 0x00 0x01 0x00 0x00 0xd3 0x00 0x00 0x00 0x01 0x00 0x00 0xd4 0x00 0x00 0x00 0x01 0x00 0x00 0xd5 0x00 0x00 0x00 0x01 0x00 0x00 0xd6 0x00 0x00 0x00 0x01 0x00 0x00 0xd7 0x00 0x00 0x00 0x01 0x00 0x00 0xd8 0x00 0x00 0x00 0x01 0x00 0x00 0xd9 0x00 0x00 0x00 0x01 0x00 0x00 0xda 0x00 0x00 0x00 0x01 0x00 0x00 0xdb 0x00 0x00 0x00 0x01 0x00 0x00 0xdc 0x00 0x00 0x00 0x01 0x00 0x00 0xdd 0x00 0x00 0x00 0x01 0x00 0x00>;
		};
	};

	fragment@50 {
		target = <0xffffffff>;

		__overlay__ {
			interrupt-parent = <0xffffffff>;
			interrupts = <0x05 0x02>;
			status = "okay";
		};
	};

	fragment@51 {
		target = <0xffffffff>;

		__overlay__ {
			interrupt-parent = <0xffffffff>;
			interrupts = <0x06 0x08>;
			status = "okay";
		};
	};

	fragment@52 {
		target = <0xffffffff>;

		__overlay__ {
			interrupt-parent = <0xffffffff>;
			interrupts = <0x08 0x08>;
			status = "okay";
		};
	};

	fragment@53 {
		target = <0xffffffff>;

		__overlay__ {
			interrupt-parent = <0xffffffff>;
			interrupts = <0x09 0x02>;
			status = "okay";
		};
	};

	fragment@54 {
		target = <0xffffffff>;

		__overlay__ {
			interrupt-parent = <0xffffffff>;
			interrupts = <0x45 0x08>;
			status = "okay";
		};
	};

	fragment@55 {
		target = <0xffffffff>;

		__overlay__ {
			interrupt-parent = <0xffffffff>;
			interrupts = <0x53 0x01>;
			status = "okay";
		};
	};

	fragment@56 {
		target = <0xffffffff>;

		__overlay__ {
			interrupt-parent = <0xffffffff>;
			interrupts = <0x6a 0x08>;
			status = "okay";
		};
	};

	fragment@57 {
		target = <0xffffffff>;

		__overlay__ {
			compatible = "mediatek,md1_sim1_hot_plug_eint-eint";
			interrupts = <0x00 0x08>;
			debounce = <0x00 0x2710>;
			dedicated = <0x00 0x00>;
			src_pin = <0x00 0x01>;
			sockettype = <0x00 0x00>;
			status = "okay";
		};
	};

	fragment@58 {
		target = <0xffffffff>;

		__overlay__ {
			mediatek,key-debounce = <0x400>;
			mediatek,sw-pwrkey = <0x74>;
			mediatek,hw-pwrkey = <0x08>;
			mediatek,sw-rstkey = <0x66>;
			mediatek,hw-rstkey = <0x11>;
			mediatek,use-extend-type = <0x00>;
			mediatek,hw-map-num = <0x48>;
			mediatek,hw-init-map = <0x72 0x73 0x00 0x00 0x00 0x00 0x00 0x00 0x00 0x00 0x00 0x00 0x00 0x00 0x00 0x00 0x00 0x00 0x00 0x00 0x00 0x00 0x00 0x00 0x00 0x00 0x00 0x00 0x00 0x00 0x00 0x00 0x00 0x00 0x00 0x00 0x00 0x00 0x00 0x00 0x00 0x00 0x00 0x00 0x00 0x00 0x00 0x00 0x00 0x00 0x00 0x00 0x00 0x00 0x00 0x00 0x00 0x00 0x00 0x00 0x00 0x00 0x00 0x00 0x00 0x00 0x00 0x00 0x00 0x00 0x00 0x00>;
			mediatek,pwrkey-eint-gpio = <0x00>;
			mediatek,pwkey-gpio-din = <0x00>;
			mediatek,hw-dl-key0 = <0x01>;
			mediatek,hw-dl-key1 = <0x00>;
			mediatek,hw-dl-key2 = <0x08>;
			mediatek,hw-recovery-key = <0x01>;
			mediatek,hw-factory-key = <0x00>;
			status = "okay";
		};
	};

	__symbols__ {
		sdio_fixed_3v3 = "/fragment@1/__overlay__/fixedregulator@0";
		mtkfb_pins_lcd_bias_enp0 = "/fragment@4/__overlay__/lcd_bias_enp0";
		mtkfb_pins_lcd_bias_enp1 = "/fragment@4/__overlay__/lcd_bias_enp1_gpio";
		mtkfb_pins_lcd_bias_enn0 = "/fragment@4/__overlay__/lcd_bias_enn0_gpio";
		mtkfb_pins_lcd_bias_enn1 = "/fragment@4/__overlay__/lcd_bias_enn1_gpio";
		mtkfb_pins_lcm_rst_out1_gpio = "/fragment@4/__overlay__/lcm_rst_out1_gpio";
		mtkfb_pins_lcm_rst_out0_gpio = "/fragment@4/__overlay__/lcm_rst_out0_gpio";
		mtkfb_pins_lcm_dsi_te = "/fragment@4/__overlay__/lcm_dsi_te";
		panel_in1 = "/fragment@7/__overlay__/panel1@0/port/endpoint";
		panel_in2 = "/fragment@7/__overlay__/panel2@0/port/endpoint";
		panel_in3 = "/fragment@7/__overlay__/panel3@0/port/endpoint";
		dsi_out = "/fragment@7/__overlay__/ports/port/endpoint";
		gps_pins_default = "/fragment@8/__overlay__/gps_default";
		gps_l1_lna_pins_ol = "/fragment@8/__overlay__/gps_l1_lna@0";
		gps_l1_lna_pins_dsp_ctrl = "/fragment@8/__overlay__/gps_l1_lna@1";
		gps_l1_lna_pins_oh = "/fragment@8/__overlay__/gps_l1_lna@2";
		gps_l5_lna_pins_ol = "/fragment@8/__overlay__/gps_l5_lna@0";
		gps_l5_lna_pins_dsp_ctrl = "/fragment@8/__overlay__/gps_l5_lna@1";
		gps_l5_lna_pins_oh = "/fragment@8/__overlay__/gps_l5_lna@2";
		lm3643 = "/fragment@10/__overlay__/lm3643@63";
		fl_core_0 = "/fragment@10/__overlay__/lm3643@63/flash@0/port@0/endpoint";
		fl_core_1 = "/fragment@10/__overlay__/lm3643@63/flash@1/port@1/endpoint";
		lm3643_pins_default = "/fragment@11/__overlay__/default";
		lm3643_pins_hwen_high = "/fragment@11/__overlay__/hwen_high";
		lm3643_pins_hwen_low = "/fragment@11/__overlay__/hwen_low";
		flashlight_0 = "/fragment@12/__overlay__/port@0/endpoint";
		flashlight_1 = "/fragment@12/__overlay__/port@1/endpoint";
		aw883xx_smartpa_0 = "/fragment@13/__overlay__/aw883xx_smartpa@34";
		aw883xx_smartpa_1 = "/fragment@13/__overlay__/aw883xx_smartpa@36";
		aw883xx_smartpa_2 = "/fragment@13/__overlay__/aw883xx_smartpa@35";
		aw883xx_smartpa_3 = "/fragment@13/__overlay__/aw883xx_smartpa@37";
		nu2116a = "/fragment@19/__overlay__/nu2116a-standalone@6E";
		ts_int_default = "/fragment@20/__overlay__/tsintdefault";
		ts_int_output_low = "/fragment@20/__overlay__/tsintoutlow";
		ts_int_output_high = "/fragment@20/__overlay__/tsintouthigh";
		ts_int_input = "/fragment@20/__overlay__/tsintinput";
		st21nfc = "/fragment@22/__overlay__/st21nfc@08";
		extcon_pins_default = "/fragment@23/__overlay__/extcon_pins_default";
		extcon_pins_otg_vbus_high = "/fragment@23/__overlay__/extcon_pins_otg_vbus_high";
		extcon_pins_otg_vbus_low = "/fragment@23/__overlay__/extcon_pins_otg_vbus_low";
		odm_usb_hub_pins_default = "/fragment@25/__overlay__/odm_usb_hub_pins_default";
		odm_usb_hub_pins_typec_usb_switch_high = "/fragment@25/__overlay__/odm_usb_hub_pins_typec_usb_switch_high";
		odm_usb_hub_pins_typec_usb_switch_low = "/fragment@25/__overlay__/odm_usb_hub_pins_typec_usb_switch_low";
		odm_usb_hub_pins_keyboard_usb_switch_high = "/fragment@25/__overlay__/odm_usb_hub_pins_keyboard_usb_switch_high";
		odm_usb_hub_pins_keyboard_usb_switch_low = "/fragment@25/__overlay__/odm_usb_hub_pins_keyboard_usb_switch_low";
		spi5_miso = "/fragment@30/__overlay__/spi5_miso_init";
		spi5_mosi = "/fragment@30/__overlay__/spi5_mosi_init";
		spi5_cs = "/fragment@30/__overlay__/spi5_cs_init";
		spi5_clk = "/fragment@30/__overlay__/spi5_clk_init";
		fingerprint_default = "/fragment@34/__overlay__/state_default";
		fingerprint_reset_high = "/fragment@34/__overlay__/state_spi_rst_high";
		fingerprint_reset_low = "/fragment@34/__overlay__/state_spi_rst_low";
		fingerprint_eint = "/fragment@34/__overlay__/state_spi_eint_init";
		fingerprint_spi_mi = "/fragment@34/__overlay__/state_spi_miso_init";
		fingerprint_spi_mo = "/fragment@34/__overlay__/state_spi_mosi_init";
		fingerprint_spi_cs = "/fragment@34/__overlay__/state_spi_cs_init";
		fingerprint_spi_clk = "/fragment@34/__overlay__/state_spi_ck_init";
		camera_pins_cam0_rst_0 = "/fragment@36/__overlay__/cam0@0";
		camera_pins_cam0_rst_1 = "/fragment@36/__overlay__/cam0@1";
		camera_pins_cam0_pnd_0 = "/fragment@36/__overlay__/cam0@2";
		camera_pins_cam0_pnd_1 = "/fragment@36/__overlay__/cam0@3";
		camera_pins_cam0_ldo_vcamio_0 = "/fragment@36/__overlay__/cam0@4";
		camera_pins_cam0_ldo_vcamio_1 = "/fragment@36/__overlay__/cam0@5";
		camera_pins_cam0_ldo_vcamaf_0 = "/fragment@36/__overlay__/cam0_vcamaf@0";
		camera_pins_cam0_ldo_vcamaf_1 = "/fragment@36/__overlay__/cam0_vcamaf@1";
		camera_pins_cam1_rst_0 = "/fragment@36/__overlay__/cam1@0";
		camera_pins_cam1_rst_1 = "/fragment@36/__overlay__/cam1@1";
		camera_pins_cam1_pnd_0 = "/fragment@36/__overlay__/cam1@2";
		camera_pins_cam1_pnd_1 = "/fragment@36/__overlay__/cam1@3";
		camera_pins_cam1_ldo_vcamio_0 = "/fragment@36/__overlay__/cam1@4";
		camera_pins_cam1_ldo_vcamio_1 = "/fragment@36/__overlay__/cam1@5";
		camera_pins_cam2_rst_0 = "/fragment@36/__overlay__/cam2@0";
		camera_pins_cam2_rst_1 = "/fragment@36/__overlay__/cam2@1";
		camera_pins_cam2_pnd_0 = "/fragment@36/__overlay__/cam2@2";
		camera_pins_cam2_pnd_1 = "/fragment@36/__overlay__/cam2@3";
		camera_pins_cam2_ldo_vcamio_0 = "/fragment@36/__overlay__/cam2@4";
		camera_pins_cam2_ldo_vcamio_1 = "/fragment@36/__overlay__/cam2@5";
		camera_pins_cam2_ldo_vcamaf_0 = "/fragment@36/__overlay__/cam2_vcamaf@0";
		camera_pins_cam2_ldo_vcamaf_1 = "/fragment@36/__overlay__/cam2_vcamaf@1";
		camera_pins_cam3_rst_0 = "/fragment@36/__overlay__/cam3@0";
		camera_pins_cam3_rst_1 = "/fragment@36/__overlay__/cam3@1";
		camera_pins_cam3_pnd_0 = "/fragment@36/__overlay__/cam3@2";
		camera_pins_cam3_pnd_1 = "/fragment@36/__overlay__/cam3@3";
		camera_pins_cam3_ldo_vcamio_0 = "/fragment@36/__overlay__/cam3@4";
		camera_pins_cam3_ldo_vcamio_1 = "/fragment@36/__overlay__/cam3@5";
		camera_pins_cam0_mclk_off = "/fragment@36/__overlay__/camera_pins_cam0_mclk_off";
		camera_pins_cam0_mclk_2ma = "/fragment@36/__overlay__/camera_pins_cam0_mclk_2ma";
		camera_pins_cam0_mclk_4ma = "/fragment@36/__overlay__/camera_pins_cam0_mclk_4ma";
		camera_pins_cam0_mclk_6ma = "/fragment@36/__overlay__/camera_pins_cam0_mclk_6ma";
		camera_pins_cam0_mclk_8ma = "/fragment@36/__overlay__/camera_pins_cam0_mclk_8ma";
		camera_pins_cam1_mclk_off = "/fragment@36/__overlay__/camera_pins_cam1_mclk_off";
		camera_pins_cam1_mclk_2ma = "/fragment@36/__overlay__/camera_pins_cam1_mclk_2ma";
		camera_pins_cam1_mclk_4ma = "/fragment@36/__overlay__/camera_pins_cam1_mclk_4ma";
		camera_pins_cam1_mclk_6ma = "/fragment@36/__overlay__/camera_pins_cam1_mclk_6ma";
		camera_pins_cam1_mclk_8ma = "/fragment@36/__overlay__/camera_pins_cam1_mclk_8ma";
		camera_pins_cam2_mclk_off = "/fragment@36/__overlay__/camera_pins_cam2_mclk_off";
		camera_pins_cam2_mclk_2ma = "/fragment@36/__overlay__/camera_pins_cam2_mclk_2ma";
		camera_pins_cam2_mclk_4ma = "/fragment@36/__overlay__/camera_pins_cam2_mclk_4ma";
		camera_pins_cam2_mclk_6ma = "/fragment@36/__overlay__/camera_pins_cam2_mclk_6ma";
		camera_pins_cam2_mclk_8ma = "/fragment@36/__overlay__/camera_pins_cam2_mclk_8ma";
		camera_pins_cam3_mclk_off = "/fragment@36/__overlay__/camera_pins_cam3_mclk_off";
		camera_pins_cam3_mclk_2ma = "/fragment@36/__overlay__/camera_pins_cam3_mclk_2ma";
		camera_pins_cam3_mclk_4ma = "/fragment@36/__overlay__/camera_pins_cam3_mclk_4ma";
		camera_pins_cam3_mclk_6ma = "/fragment@36/__overlay__/camera_pins_cam3_mclk_6ma";
		camera_pins_cam3_mclk_8ma = "/fragment@36/__overlay__/camera_pins_cam3_mclk_8ma";
		cam_mipi_switch_en_0 = "/fragment@36/__overlay__/cam_mipi_switch_en_off@0";
		cam_mipi_switch_en_1 = "/fragment@36/__overlay__/cam_mipi_switch_en_on@1";
		cam_mipi_switch_sel_0 = "/fragment@36/__overlay__/cam_mipi_switch_sel_off@0";
		cam_mipi_switch_sel_1 = "/fragment@36/__overlay__/cam_mipi_switch_sel_on@1";
		camera_pins_default = "/fragment@36/__overlay__/camdefault";
		camera_sub_mtk = "/fragment@38/__overlay__/camera_sub@1a";
		camera_main_two_mtk = "/fragment@38/__overlay__/camera_main_two@1b";
		camera_main_two_af_mtk = "/fragment@38/__overlay__/camera_main_two_af@1c";
		camera_main_af_mtk = "/fragment@39/__overlay__/camera_main_af@72";
		mtk_camera_eeprom0 = "/fragment@39/__overlay__/camera_eeprom0@50";
		camera_main_mtk = "/fragment@39/__overlay__/camera_main@1a";
		camera_sub_two_mtk = "/fragment@39/__overlay__/camera_sub_two@73";
		mmc0_pins_default = "/fragment@44/__overlay__/mmc0default";
		mmc0_pins_uhs = "/fragment@44/__overlay__/mmc0@0";
		mmc0_pins_pull_down = "/fragment@44/__overlay__/mmc0@1";
		aw37501 = "/fragment@45/__overlay__/aw37501@3e";
		it6112 = "/fragment@45/__overlay__/it6112@56";
	};

	__fixups__ {
		chosen = "/fragment@0:target:0\0/fragment@18/__overlay__:bootmode:0";
		odm = "/fragment@1:target:0";
		pio = "/fragment@1/__overlay__/fixedregulator@0:gpio:0\0/fragment@4:target:0\0/fragment@7/__overlay__/panel1@0:reset-gpios:0\0/fragment@7/__overlay__/panel1@0:bias-gpios:0\0/fragment@7/__overlay__/panel1@0:bias-gpios:12\0/fragment@7/__overlay__/panel2@0:reset-gpios:0\0/fragment@7/__overlay__/panel2@0:bias-gpios:0\0/fragment@7/__overlay__/panel2@0:bias-gpios:12\0/fragment@7/__overlay__/panel3@0:reset-gpios:0\0/fragment@7/__overlay__/panel3@0:bias-gpios:0\0/fragment@7/__overlay__/panel3@0:bias-gpios:12\0/fragment@8:target:0\0/fragment@11:target:0\0/fragment@13/__overlay__/aw883xx_smartpa@34:reset-gpio:0\0/fragment@15/__overlay__/aw35615@22:awinic,int_n:0\0/fragment@19/__overlay__/nu2116a-standalone@6E:irq-gpios:0\0/fragment@20:target:0\0/fragment@21/__overlay__:cd-gpios:0\0/fragment@22/__overlay__/st21nfc@08:interrupt-parent:0\0/fragment@22/__overlay__/st21nfc@08:reset-gpios:0\0/fragment@22/__overlay__/st21nfc@08:irq-gpios:0\0/fragment@22/__overlay__/st21nfc@08:clkreq-gpios:0\0/fragment@23:target:0\0/fragment@24/__overlay__:id-gpios:0\0/fragment@25:target:0\0/fragment@28/__overlay__/ch9434@0:ch9434,int-gpio:0\0/fragment@30:target:0\0/fragment@31/__overlay__:spi5_cs2:0\0/fragment@31/__overlay__:spi5_cs3:0\0/fragment@31/__overlay__:hdmi_spi_lsen:0\0/fragment@31/__overlay__:fpga_121_en:0\0/fragment@31/__overlay__:fpga_256_en:0\0/fragment@32/__overlay__:cs-gpios:0\0/fragment@32/__overlay__:cs-gpios:12\0/fragment@34:target:0\0/fragment@36:target:0\0/fragment@44:target:0\0/fragment@47/__overlay__/focaltech@0:interrupt-parent:0\0/fragment@47/__overlay__/focaltech@0:focaltech,reset-gpio:0\0/fragment@47/__overlay__/focaltech@0:focaltech,irq-gpio:0\0/fragment@47/__overlay__/focaltech@0:chipone,rst-gpio:0\0/fragment@47/__overlay__/focaltech@0:chipone,irq-gpio:0\0/fragment@48/__overlay__:GPIO_SIM1_HOT_PLUG:0\0/fragment@48/__overlay__:GPIO_FDD_BAND_SUPPORT_DETECT_3RD_PIN:0\0/fragment@48/__overlay__:GPIO_FDD_BAND_SUPPORT_DETECT_2ND_PIN:0\0/fragment@48/__overlay__:GPIO_FDD_BAND_SUPPORT_DETECT_1ST_PIN:0\0/fragment@48/__overlay__:GPIO_SIM1_SCLK:0\0/fragment@48/__overlay__:GPIO_SIM1_SRST:0\0/fragment@48/__overlay__:GPIO_SIM1_SIO:0\0/fragment@48/__overlay__:GPIO_SIM2_SCLK:0\0/fragment@48/__overlay__:GPIO_SIM2_SRST:0\0/fragment@48/__overlay__:GPIO_SIM2_SIO:0\0/fragment@50/__overlay__:interrupt-parent:0\0/fragment@51/__overlay__:interrupt-parent:0\0/fragment@52/__overlay__:interrupt-parent:0\0/fragment@53/__overlay__:interrupt-parent:0\0/fragment@54/__overlay__:interrupt-parent:0\0/fragment@55/__overlay__:interrupt-parent:0\0/fragment@56/__overlay__:interrupt-parent:0";
		android = "/fragment@2:target:0";
		mtk_leds = "/fragment@3:target:0";
		disp_pwm = "/fragment@3/__overlay__/backlight:pwms:0";
		mtkfb = "/fragment@5:target:0";
		dispsys_config = "/fragment@6:target:0";
		dsi0 = "/fragment@7:target:0";
		gps = "/fragment@9:target:0";
		i2c6 = "/fragment@10:target:0\0/fragment@15:target:0";
		mtk_composite_v4l2_1 = "/fragment@12:target:0";
		i2c8 = "/fragment@13:target:0";
		sound = "/fragment@14:target:0";
		lk_charger = "/fragment@16:target:0";
		pe4 = "/fragment@17:target:0";
		mtk_gauge = "/fragment@17/__overlay__:gauge:0\0/fragment@18/__overlay__:gauge:0\0/fragment@35:target:0";
		charger = "/fragment@18:target:0";
		sc8960x = "/fragment@18/__overlay__:charger:0";
		i2c7 = "/fragment@19:target:0";
		mmc1 = "/fragment@21:target:0";
		mt6358_vmch_eint_low = "/fragment@21/__overlay__:vmmc-supply:0";
		mt6358_vmc_reg = "/fragment@21/__overlay__:vqmmc-supply:0";
		dvfsrc_vcore = "/fragment@21/__overlay__:dvfsrc-vcore-supply:0";
		i2c3 = "/fragment@22:target:0\0/fragment@41:target:0\0/fragment@46:target:0";
		extcon_usb = "/fragment@24:target:0";
		odm_usb_hub = "/fragment@26:target:0";
		i2c2 = "/fragment@27:target:0\0/fragment@39:target:0";
		spi1 = "/fragment@28:target:0";
		i2c9 = "/fragment@29:target:0\0/fragment@45:target:0";
		tiny1c = "/fragment@31:target:0";
		spi5 = "/fragment@32:target:0";
		goodix_fp = "/fragment@33:target:0\0/fragment@52:target:0";
		pmic_auxadc = "/fragment@35/__overlay__:io-channels:0\0/fragment@35/__overlay__:io-channels:8\0/fragment@35/__overlay__:io-channels:16\0/fragment@35/__overlay__:io-channels:24\0/fragment@35/__overlay__:io-channels:32";
		auxadc = "/fragment@35/__overlay__:io-channels:40";
		kd_camera_hw1 = "/fragment@37:target:0";
		i2c4 = "/fragment@38:target:0";
		aw37004dnr_reg = "/fragment@40:target:0";
		i2c5 = "/fragment@42:target:0\0/fragment@43:target:0";
		spi0 = "/fragment@47:target:0";
		gpio_usage_mapping = "/fragment@48:target:0";
		gpio = "/fragment@49:target:0";
		rt5133_eint = "/fragment@50:target:0";
		smart_pa = "/fragment@51:target:0";
		touch = "/fragment@53:target:0";
		ch9434 = "/fragment@54:target:0";
		dsi_te = "/fragment@55:target:0";
		otg_iddig = "/fragment@56:target:0";
		md1_sim1_hot_plug_eint = "/fragment@57:target:0";
		keypad = "/fragment@58:target:0";
	};

	__local_fixups__ {

		fragment@5 {

			__overlay__ {
				pinctrl-0 = <0x00>;
				pinctrl-1 = <0x00>;
				pinctrl-2 = <0x00>;
				pinctrl-3 = <0x00>;
				pinctrl-4 = <0x00>;
				pinctrl-5 = <0x00>;
				pinctrl-6 = <0x00>;
			};
		};

		fragment@6 {

			__overlay__ {
				pinctrl-0 = <0x00>;
				pinctrl-1 = <0x00>;
				pinctrl-2 = <0x00>;
			};
		};

		fragment@7 {

			__overlay__ {

				panel1@0 {

					port {

						endpoint {
							remote-endpoint = <0x00>;
						};
					};
				};

				panel2@0 {

					port {

						endpoint {
							remote-endpoint = <0x00>;
						};
					};
				};

				panel3@0 {

					port {

						endpoint {
							remote-endpoint = <0x00>;
						};
					};
				};

				ports {

					port {

						endpoint {
							remote-endpoint = <0x00>;
						};
					};
				};
			};
		};

		fragment@9 {

			__overlay__ {
				pinctrl-0 = <0x00>;
				pinctrl-1 = <0x00>;
				pinctrl-2 = <0x00>;
				pinctrl-3 = <0x00>;
				pinctrl-4 = <0x00>;
				pinctrl-5 = <0x00>;
				pinctrl-6 = <0x00>;
			};
		};

		fragment@10 {

			__overlay__ {

				lm3643@63 {
					pinctrl-0 = <0x00>;
					pinctrl-1 = <0x00>;
					pinctrl-2 = <0x00>;

					flash@0 {

						port@0 {

							endpoint {
								remote-endpoint = <0x00>;
							};
						};
					};

					flash@1 {

						port@1 {

							endpoint {
								remote-endpoint = <0x00>;
							};
						};
					};
				};
			};
		};

		fragment@12 {

			__overlay__ {

				port@0 {

					endpoint {
						remote-endpoint = <0x00>;
					};
				};

				port@1 {

					endpoint {
						remote-endpoint = <0x00>;
					};
				};
			};
		};

		fragment@14 {

			__overlay__ {

				mediatek,speaker-codec {
					sound-dai = <0x00 0x04 0x08 0x0c>;
				};
			};
		};

		fragment@24 {

			__overlay__ {
				pinctrl-0 = <0x00>;
				pinctrl-1 = <0x00>;
				pinctrl-2 = <0x00>;
			};
		};

		fragment@26 {

			__overlay__ {
				pinctrl-0 = <0x00>;
				pinctrl-1 = <0x00>;
				pinctrl-2 = <0x00>;
				pinctrl-3 = <0x00>;
				pinctrl-4 = <0x00>;
			};
		};

		fragment@31 {

			__overlay__ {
				pinctrl-0 = <0x00>;
				pinctrl-1 = <0x00>;
				pinctrl-2 = <0x00>;
				pinctrl-3 = <0x00>;
			};
		};

		fragment@33 {

			__overlay__ {
				pinctrl-0 = <0x00>;
				pinctrl-1 = <0x00>;
				pinctrl-2 = <0x00>;
				pinctrl-3 = <0x00>;
				pinctrl-4 = <0x00>;
				pinctrl-5 = <0x00>;
				pinctrl-6 = <0x00>;
				pinctrl-7 = <0x00>;
			};
		};

		fragment@37 {

			__overlay__ {
				pinctrl-0 = <0x00>;
				pinctrl-1 = <0x00>;
				pinctrl-2 = <0x00>;
				pinctrl-3 = <0x00>;
				pinctrl-4 = <0x00>;
				pinctrl-5 = <0x00>;
				pinctrl-6 = <0x00>;
				pinctrl-7 = <0x00>;
				pinctrl-8 = <0x00>;
				pinctrl-9 = <0x00>;
				pinctrl-10 = <0x00>;
				pinctrl-11 = <0x00>;
				pinctrl-12 = <0x00>;
				pinctrl-13 = <0x00>;
				pinctrl-14 = <0x00>;
				pinctrl-15 = <0x00>;
				pinctrl-16 = <0x00>;
				pinctrl-17 = <0x00>;
				pinctrl-18 = <0x00>;
				pinctrl-19 = <0x00>;
				pinctrl-20 = <0x00>;
				pinctrl-21 = <0x00>;
				pinctrl-22 = <0x00>;
				pinctrl-23 = <0x00>;
				pinctrl-24 = <0x00>;
				pinctrl-25 = <0x00>;
				pinctrl-26 = <0x00>;
				pinctrl-27 = <0x00>;
				pinctrl-28 = <0x00>;
				pinctrl-29 = <0x00>;
				pinctrl-30 = <0x00>;
				pinctrl-31 = <0x00>;
				pinctrl-32 = <0x00>;
				pinctrl-33 = <0x00>;
				pinctrl-34 = <0x00>;
				pinctrl-35 = <0x00>;
				pinctrl-36 = <0x00>;
				pinctrl-37 = <0x00>;
				pinctrl-38 = <0x00>;
				pinctrl-39 = <0x00>;
				pinctrl-40 = <0x00>;
				pinctrl-41 = <0x00>;
				pinctrl-42 = <0x00>;
				pinctrl-43 = <0x00>;
				pinctrl-44 = <0x00>;
				pinctrl-45 = <0x00>;
				pinctrl-46 = <0x00>;
				pinctrl-47 = <0x00>;
				pinctrl-48 = <0x00>;
				pinctrl-49 = <0x00>;
				pinctrl-50 = <0x00>;
				pinctrl-51 = <0x00>;
				pinctrl-52 = <0x00>;
			};
		};
	};
};
